// Keymap Windows fixe : la couche zéro reste le même OS après redémarrage.
#include "common/fixed-layers.h"
#include "common/behaviors.dtsi"

// · : action héritée d’une couche inférieure. ∅ : aucune action.
// Dans é/É ou à/â/À, les actions suivent le nombre d’appuis. → : appui bref puis maintien.
// L1 : primaire, double appui secondaire, triple appui pavé. L2 : secondaire, double primaire.
// Les encadrés extérieurs indiquent les deux actions de rotation, dans l’ordre des bindings.

// Base et encodeurs.
// Paramètres OS de la base commune.
#define BASE_LAYER(bindings, sensors) LAYER(BASE, bindings, sensors)
#define BASE_CTRL &kp LCTRL
#define BASE_ALT &kp LALT
#define BASE_DOT &dot_excl
#define BASE_BSLS &colon_bsls
#define BASE_GUI &kp LGUI
#define BASE_OS &win

// ┏━━━━━━━━━━━┳━━━━━━━━━━━┳━━━━━━━━━━━┳━━━━━━━━━━━┳━━━━━━━━━━━┳━━━━━━━━━━━┓   ┏━━━━━━━━━━━┳━━━━━━━━━━━┳━━━━━━━━━━━┳━━━━━━━━━━━┳━━━━━━━━━━━┳━━━━━━━━━━━┓
// ┃    ESC    ┃     A     ┃     Z     ┃     E     ┃     R     ┃     T     ┃   ┃     Y     ┃     U     ┃     I     ┃     O     ┃     P     ┃   BSPACE  ┃
// ┣━━━━━━━━━━━╋━━━━━━━━━━━╋━━━━━━━━━━━╋━━━━━━━━━━━╋━━━━━━━━━━━╋━━━━━━━━━━━┫   ┣━━━━━━━━━━━╋━━━━━━━━━━━╋━━━━━━━━━━━╋━━━━━━━━━━━╋━━━━━━━━━━━╋━━━━━━━━━━━┫
// ┃    TAB    ┃     Q     ┃     S     ┃     D     ┃     F     ┃     G     ┃   ┃     H     ┃     J     ┃     K     ┃     L     ┃     M     ┃    DEL    ┃
// ┗━━━━━━━━━━━╋━━━━━━━━━━━╋━━━━━━━━━━━╋━━━━━━━━━━━╋━━━━━━━━━━━╋━━━━━━━━━━━┫   ┣━━━━━━━━━━━╋━━━━━━━━━━━╋━━━━━━━━━━━╋━━━━━━━━━━━╋━━━━━━━━━━━╋━━━━━━━━━━━┛
//             ┃     W     ┃     X     ┃     C     ┃     V     ┃     B     ┃   ┃     N     ┃   , ou ?  ┃   . ou !  ┃   ; ou /  ┃   : ou \  ┃
// ╭───────╮   ┗━━━━━━━━━━━┻━━━━━━━━━━━┻━━━━━━━━━━━┻━━━━━━━━━━━┻━━━━━━━━━━━┛   ┗━━━━━━━━━━━┻━━━━━━━━━━━┻━━━━━━━━━━━┻━━━━━━━━━━━┻━━━━━━━━━━━┛   ╭───────╮
// │  VOL- │ ┏━━━━━━━━━━━┓ ┏━━━━━━━━━━━┳━━━━━━━━━━━┳━━━━━━━━━━━┳━━━━━━━━━━━┓   ┏━━━━━━━━━━━┳━━━━━━━━━━━┳━━━━━━━━━━━┳━━━━━━━━━━━┓ ┏━━━━━━━━━━━┓ │  LEFT │
// │  VOL+ │ ┃ Play→Mute ┃ ┃    CTRL   ┃    ALT    ┃     L2    ┃   SPACE   ┃   ┃ SHIFT+LOCK┃     L1    ┃   ENTER   ┃    WIN    ┃ ┃  Windows  ┃ │ RIGHT │
// ╰───────╯ ┗━━━━━━━━━━━┛ ┗━━━━━━━━━━━┻━━━━━━━━━━━┻━━━━━━━━━━━┻━━━━━━━━━━━┛   ┗━━━━━━━━━━━┻━━━━━━━━━━━┻━━━━━━━━━━━┻━━━━━━━━━━━┛ ┗━━━━━━━━━━━┛ ╰───────╯
#include "common/base-layer.dtsi"

// Navigation et symboles.
LAYER(PRIMARY,
// ┏━━━━━━━━━━━┳━━━━━━━━━━━┳━━━━━━━━━━━┳━━━━━━━━━━━┳━━━━━━━━━━━┳━━━━━━━━━━━┓   ┏━━━━━━━━━━━┳━━━━━━━━━━━┳━━━━━━━━━━━┳━━━━━━━━━━━┳━━━━━━━━━━━┳━━━━━━━━━━━┓
// ┃     ∅     ┃     ∅     ┃    HOME   ┃     ∅     ┃    END    ┃     ∅     ┃   ┃     "     ┃     (     ┃     )     ┃     [     ┃     ]     ┃     ·     ┃
// ┣━━━━━━━━━━━╋━━━━━━━━━━━╋━━━━━━━━━━━╋━━━━━━━━━━━╋━━━━━━━━━━━╋━━━━━━━━━━━┫   ┣━━━━━━━━━━━╋━━━━━━━━━━━╋━━━━━━━━━━━╋━━━━━━━━━━━╋━━━━━━━━━━━╋━━━━━━━━━━━┫
// ┃     ∅     ┃     ∅     ┃     ←     ┃     ↑     ┃     →     ┃     ->    ┃   ┃     '     ┃     {     ┃     }     ┃     <     ┃     >     ┃     ·     ┃
// ┗━━━━━━━━━━━╋━━━━━━━━━━━╋━━━━━━━━━━━╋━━━━━━━━━━━╋━━━━━━━━━━━╋━━━━━━━━━━━┫   ┣━━━━━━━━━━━╋━━━━━━━━━━━╋━━━━━━━━━━━╋━━━━━━━━━━━╋━━━━━━━━━━━╋━━━━━━━━━━━┛
//             ┃     ∅     ┃   CTRL ←  ┃     ↓     ┃   CTRL →  ┃     =>    ┃   ┃     `     ┃     #     ┃     &     ┃     |     ┃     @     ┃
// ╭───────╮   ┗━━━━━━━━━━━┻━━━━━━━━━━━┻━━━━━━━━━━━┻━━━━━━━━━━━┻━━━━━━━━━━━┛   ┗━━━━━━━━━━━┻━━━━━━━━━━━┻━━━━━━━━━━━┻━━━━━━━━━━━┻━━━━━━━━━━━┛   ╭───────╮
// │  LEFT │ ┏━━━━━━━━━━━┓ ┏━━━━━━━━━━━┳━━━━━━━━━━━┳━━━━━━━━━━━┳━━━━━━━━━━━┓   ┏━━━━━━━━━━━┳━━━━━━━━━━━┳━━━━━━━━━━━┳━━━━━━━━━━━┓ ┏━━━━━━━━━━━┓ │   UP  │
// │ RIGHT │ ┃     ∅     ┃ ┃     ·     ┃     ·     ┃     ·     ┃   SHIFT   ┃   ┃   SHIFT   ┃     ·     ┃     ·     ┃     ·     ┃ ┃     ∅     ┃ │  DOWN │
// ╰───────╯ ┗━━━━━━━━━━━┛ ┗━━━━━━━━━━━┻━━━━━━━━━━━┻━━━━━━━━━━━┻━━━━━━━━━━━┛   ┗━━━━━━━━━━━┻━━━━━━━━━━━┻━━━━━━━━━━━┻━━━━━━━━━━━┛ ┗━━━━━━━━━━━┛ ╰───────╯
    no___       no___       &kp HOME    no___       &kp END     no___
    no___       no___       &kp LEFT    &kp UP      &kp RIGHT   &fr_arw_s
                no___       &kp CLEFT   &kp DOWN    &kp CRIGHT  &fr_arw_d
            no___           trs__       trs__       trs__       &kp LSHIFT
                                                                                &quot       &lpar       &rpar       &lcro       &rcro       trs__
                                                                                &squo       &lacc       &racc       &lche       &rche       trs__
                                                                                &fr_grv     &hash       &and        &pipe       &at
                                                                                &kp LSHIFT  trs__       trs__       trs__       no___
, &inc_dec_kp LEFT RIGHT                                                        &inc_dec_kp UP DOWN)

// Accents et nombres.
LAYER(SECONDARY,
// ┏━━━━━━━━━━━┳━━━━━━━━━━━┳━━━━━━━━━━━┳━━━━━━━━━━━┳━━━━━━━━━━━┳━━━━━━━━━━━┓   ┏━━━━━━━━━━━┳━━━━━━━━━━━┳━━━━━━━━━━━┳━━━━━━━━━━━┳━━━━━━━━━━━┳━━━━━━━━━━━┓
// ┃   BSPACE  ┃    œ/Œ    ┃   °/²/³   ┃     _     ┃     -     ┃     +     ┃   ┃     =     ┃     7     ┃     8     ┃     9     ┃    €/£    ┃     ·     ┃
// ┣━━━━━━━━━━━╋━━━━━━━━━━━╋━━━━━━━━━━━╋━━━━━━━━━━━╋━━━━━━━━━━━╋━━━━━━━━━━━┫   ┣━━━━━━━━━━━╋━━━━━━━━━━━╋━━━━━━━━━━━╋━━━━━━━━━━━╋━━━━━━━━━━━╋━━━━━━━━━━━┫
// ┃    DEL    ┃    ô/Ô    ┃    é/É    ┃    ê/Ê    ┃    è/ë    ┃     *     ┃   ┃     0     ┃     4     ┃     5     ┃     6     ┃     $     ┃     ·     ┃
// ┗━━━━━━━━━━━╋━━━━━━━━━━━╋━━━━━━━━━━━╋━━━━━━━━━━━╋━━━━━━━━━━━╋━━━━━━━━━━━┫   ┣━━━━━━━━━━━╋━━━━━━━━━━━╋━━━━━━━━━━━╋━━━━━━━━━━━╋━━━━━━━━━━━╋━━━━━━━━━━━┛
//             ┃    î/ï    ┃   ù/û/µ   ┃    ç/Ç    ┃   à/â/À   ┃     /     ┃   ┃     .     ┃     1     ┃     2     ┃     3     ┃     %     ┃
// ╭───────╮   ┗━━━━━━━━━━━┻━━━━━━━━━━━┻━━━━━━━━━━━┻━━━━━━━━━━━┻━━━━━━━━━━━┛   ┗━━━━━━━━━━━┻━━━━━━━━━━━┻━━━━━━━━━━━┻━━━━━━━━━━━┻━━━━━━━━━━━┛   ╭───────╮
// │  LEFT │ ┏━━━━━━━━━━━┓ ┏━━━━━━━━━━━┳━━━━━━━━━━━┳━━━━━━━━━━━┳━━━━━━━━━━━┓   ┏━━━━━━━━━━━┳━━━━━━━━━━━┳━━━━━━━━━━━┳━━━━━━━━━━━┓ ┏━━━━━━━━━━━┓ │   UP  │
// │ RIGHT │ ┃     ∅     ┃ ┃     ·     ┃     ·     ┃     ·     ┃   ENTER   ┃   ┃   SPACE   ┃     ·     ┃     ·     ┃     ·     ┃ ┃     ∅     ┃ │  DOWN │
// ╰───────╯ ┗━━━━━━━━━━━┛ ┗━━━━━━━━━━━┻━━━━━━━━━━━┻━━━━━━━━━━━┻━━━━━━━━━━━┛   ┗━━━━━━━━━━━┻━━━━━━━━━━━┻━━━━━━━━━━━┻━━━━━━━━━━━┛ ┗━━━━━━━━━━━┛ ╰───────╯
    &kp BSPC    &oe_oeu     &nb_2_3     &udsc       &mins       &plus
    &kp DEL     &oc_ocu     &ea_eau     &ec_ecu     &eg_et      &astr
                &ic_it      &ug_uc      &cc_ccu     &ag_agu_ac  &divi
            no___           trs__       trs__       trs__       &kp ENTER
                                                                                &eqal       &n_7        &n_8        &n_9        &eu_li      trs__
                                                                                &n_0        &n_4        &n_5        &n_6        &dolr       trs__
                                                                                &n_dt       &n_1        &n_2        &n_3        &perc
                                                                                &kp SPACE   trs__       trs__       trs__       no___
, &inc_dec_kp LEFT RIGHT                                                        &inc_dec_kp UP DOWN)

// Fonctions et système.
LAYER(TERTIARY,
// ┏━━━━━━━━━━━┳━━━━━━━━━━━┳━━━━━━━━━━━┳━━━━━━━━━━━┳━━━━━━━━━━━┳━━━━━━━━━━━┓   ┏━━━━━━━━━━━┳━━━━━━━━━━━┳━━━━━━━━━━━┳━━━━━━━━━━━┳━━━━━━━━━━━┳━━━━━━━━━━━┓
// ┃     F1    ┃     F2    ┃     F3    ┃     F4    ┃     F5    ┃     F6    ┃   ┃     F7    ┃     F8    ┃     F9    ┃    F10    ┃    F11    ┃    F12    ┃
// ┣━━━━━━━━━━━╋━━━━━━━━━━━╋━━━━━━━━━━━╋━━━━━━━━━━━╋━━━━━━━━━━━╋━━━━━━━━━━━┫   ┣━━━━━━━━━━━╋━━━━━━━━━━━╋━━━━━━━━━━━╋━━━━━━━━━━━╋━━━━━━━━━━━╋━━━━━━━━━━━┫
// ┃   Reset   ┃     ∅     ┃  ← texte  ┃  ↑ texte  ┃  → texte  ┃     ∅     ┃   ┃     ∅     ┃   ` mort  ┃   ^ mort  ┃   ¨ mort  ┃   ~ mort  ┃   ALT+F4  ┃
// ┗━━━━━━━━━━━╋━━━━━━━━━━━╋━━━━━━━━━━━╋━━━━━━━━━━━╋━━━━━━━━━━━╋━━━━━━━━━━━┫   ┣━━━━━━━━━━━╋━━━━━━━━━━━╋━━━━━━━━━━━╋━━━━━━━━━━━╋━━━━━━━━━━━╋━━━━━━━━━━━┛
//             ┃     ∅     ┃     ∅     ┃  ↓ texte  ┃     ∅     ┃ Imp. écran┃   ┃   Clic G  ┃   Clic D  ┃     ∅     ┃     ∅     ┃     ∅     ┃
// ╭───────╮   ┗━━━━━━━━━━━┻━━━━━━━━━━━┻━━━━━━━━━━━┻━━━━━━━━━━━┻━━━━━━━━━━━┛   ┗━━━━━━━━━━━┻━━━━━━━━━━━┻━━━━━━━━━━━┻━━━━━━━━━━━┻━━━━━━━━━━━┛   ╭───────╮
// │   UP  │ ┏━━━━━━━━━━━┓ ┏━━━━━━━━━━━┳━━━━━━━━━━━┳━━━━━━━━━━━┳━━━━━━━━━━━┓   ┏━━━━━━━━━━━┳━━━━━━━━━━━┳━━━━━━━━━━━┳━━━━━━━━━━━┓ ┏━━━━━━━━━━━┓ │  LEFT │
// │  DOWN │ ┃ Bootloader┃ ┃    CTRL   ┃    ALT    ┃     ·     ┃     ∅     ┃   ┃     ∅     ┃     ·     ┃     ∅     ┃    Jeu    ┃ ┃ Efface BLE┃ │ RIGHT │
// ╰───────╯ ┗━━━━━━━━━━━┛ ┗━━━━━━━━━━━┻━━━━━━━━━━━┻━━━━━━━━━━━┻━━━━━━━━━━━┛   ┗━━━━━━━━━━━┻━━━━━━━━━━━┻━━━━━━━━━━━┻━━━━━━━━━━━┛ ┗━━━━━━━━━━━┛ ╰───────╯
    &kp F1      &kp F2      &kp F3      &kp F4      &kp F5      &kp F6
    &sys_reset  no___       &arw_lft    &arw_up     &arw_rgt    no___
                no___       no___       &arw_dwn    no___       &kp PSCRN
            &bootloader     &kp LCTRL   &kp LALT    trs__       no___
                                                                                &kp F7      &kp F8      &kp F9      &kp F10     &kp F11     &kp F12
                                                                                no___       &kp _GRV    &kp _CIR    &kp _TRE    &kp _TLD    &kp LA(F4)
                                                                                &mkp LCLK   &mkp RCLK   no___       no___       no___
                                                                                no___       trs__       no___       &to GAMING  &bt BT_CLR_ALL
, &inc_dec_kp UP DOWN                                                           &inc_dec_kp LEFT RIGHT)

// Pavé numérique, retour à la base du même OS.
LAYER(NUMPAD,
// ┏━━━━━━━━━━━┳━━━━━━━━━━━┳━━━━━━━━━━━┳━━━━━━━━━━━┳━━━━━━━━━━━┳━━━━━━━━━━━┓   ┏━━━━━━━━━━━┳━━━━━━━━━━━┳━━━━━━━━━━━┳━━━━━━━━━━━┳━━━━━━━━━━━┳━━━━━━━━━━━┓
// ┃     ·     ┃     A     ┃     Z     ┃     ↑     ┃     -     ┃     +     ┃   ┃     =     ┃     7     ┃     8     ┃     9     ┃    €/£    ┃     ·     ┃
// ┣━━━━━━━━━━━╋━━━━━━━━━━━╋━━━━━━━━━━━╋━━━━━━━━━━━╋━━━━━━━━━━━╋━━━━━━━━━━━┫   ┣━━━━━━━━━━━╋━━━━━━━━━━━╋━━━━━━━━━━━╋━━━━━━━━━━━╋━━━━━━━━━━━╋━━━━━━━━━━━┫
// ┃     ·     ┃     Y     ┃     ←     ┃     ↓     ┃     →     ┃     *     ┃   ┃     0     ┃     4     ┃     5     ┃     6     ┃     $     ┃     ·     ┃
// ┗━━━━━━━━━━━╋━━━━━━━━━━━╋━━━━━━━━━━━╋━━━━━━━━━━━╋━━━━━━━━━━━╋━━━━━━━━━━━┫   ┣━━━━━━━━━━━╋━━━━━━━━━━━╋━━━━━━━━━━━╋━━━━━━━━━━━╋━━━━━━━━━━━╋━━━━━━━━━━━┛
//             ┃     ∅     ┃     X     ┃     C     ┃     V     ┃     /     ┃   ┃     .     ┃     1     ┃     2     ┃     3     ┃     %     ┃
// ╭───────╮   ┗━━━━━━━━━━━┻━━━━━━━━━━━┻━━━━━━━━━━━┻━━━━━━━━━━━┻━━━━━━━━━━━┛   ┗━━━━━━━━━━━┻━━━━━━━━━━━┻━━━━━━━━━━━┻━━━━━━━━━━━┻━━━━━━━━━━━┛   ╭───────╮
// │  LEFT │ ┏━━━━━━━━━━━┓ ┏━━━━━━━━━━━┳━━━━━━━━━━━┳━━━━━━━━━━━┳━━━━━━━━━━━┓   ┏━━━━━━━━━━━┳━━━━━━━━━━━┳━━━━━━━━━━━┳━━━━━━━━━━━┓ ┏━━━━━━━━━━━┓ │   UP  │
// │ RIGHT │ ┃     ∅     ┃ ┃    CTRL   ┃     ∅     ┃   BSPACE  ┃    DEL    ┃   ┃   SPACE   ┃    Base   ┃   ENTER   ┃    WIN    ┃ ┃   Numpad  ┃ │  DOWN │
// ╰───────╯ ┗━━━━━━━━━━━┛ ┗━━━━━━━━━━━┻━━━━━━━━━━━┻━━━━━━━━━━━┻━━━━━━━━━━━┛   ┗━━━━━━━━━━━┻━━━━━━━━━━━┻━━━━━━━━━━━┻━━━━━━━━━━━┛ ┗━━━━━━━━━━━┛ ╰───────╯
    trs__       &kp _A      &kp _Z      &kp UP      &mins       &plus
    trs__       &kp _Y      &kp LEFT    &kp DOWN    &kp RIGHT   &astr
                no___       &kp _X      &kp _C      &kp _V      &divi
            no___           &kp LCTRL   no___       &kp BSPC    &kp DEL
                                                                                &eqal       &n_7        &n_8        &n_9        &eu_li      trs__
                                                                                &n_0        &n_4        &n_5        &n_6        &dolr       trs__
                                                                                &n_dt       &n_1        &n_2        &n_3        &perc
                                                                                &kp SPACE   &to BASE    &kp ENTER   &kp LGUI    &numpad
, &inc_dec_kp LEFT RIGHT                                                        &inc_dec_kp UP DOWN)

// Jeu Windows.
LAYER(GAMING,
// ┏━━━━━━━━━━━┳━━━━━━━━━━━┳━━━━━━━━━━━┳━━━━━━━━━━━┳━━━━━━━━━━━┳━━━━━━━━━━━┓   ┏━━━━━━━━━━━┳━━━━━━━━━━━┳━━━━━━━━━━━┳━━━━━━━━━━━┳━━━━━━━━━━━┳━━━━━━━━━━━┓
// ┃  TAB→ESC  ┃     A     ┃     Z     ┃     E     ┃     R     ┃     T     ┃   ┃     Y     ┃     U     ┃     I     ┃     O     ┃     P     ┃   BSPACE  ┃
// ┣━━━━━━━━━━━╋━━━━━━━━━━━╋━━━━━━━━━━━╋━━━━━━━━━━━╋━━━━━━━━━━━╋━━━━━━━━━━━┫   ┣━━━━━━━━━━━╋━━━━━━━━━━━╋━━━━━━━━━━━╋━━━━━━━━━━━╋━━━━━━━━━━━╋━━━━━━━━━━━┫
// ┃    TAB    ┃     Q     ┃     S     ┃     D     ┃     F     ┃     G     ┃   ┃     H     ┃     J     ┃     K     ┃     L     ┃     M     ┃    DEL    ┃
// ┗━━━━━━━━━━━╋━━━━━━━━━━━╋━━━━━━━━━━━╋━━━━━━━━━━━╋━━━━━━━━━━━╋━━━━━━━━━━━┫   ┣━━━━━━━━━━━╋━━━━━━━━━━━╋━━━━━━━━━━━╋━━━━━━━━━━━╋━━━━━━━━━━━╋━━━━━━━━━━━┛
//             ┃     W     ┃     X     ┃     C     ┃     V     ┃     B     ┃   ┃     N     ┃   , ou ?  ┃   . ou !  ┃   ; ou /  ┃   : ou \  ┃
// ╭───────╮   ┗━━━━━━━━━━━┻━━━━━━━━━━━┻━━━━━━━━━━━┻━━━━━━━━━━━┻━━━━━━━━━━━┛   ┗━━━━━━━━━━━┻━━━━━━━━━━━┻━━━━━━━━━━━┻━━━━━━━━━━━┻━━━━━━━━━━━┛   ╭───────╮
// │  VOL- │ ┏━━━━━━━━━━━┓ ┏━━━━━━━━━━━┳━━━━━━━━━━━┳━━━━━━━━━━━┳━━━━━━━━━━━┓   ┏━━━━━━━━━━━┳━━━━━━━━━━━┳━━━━━━━━━━━┳━━━━━━━━━━━┓ ┏━━━━━━━━━━━┓ │  VOL- │
// │  VOL+ │ ┃     ∅     ┃ ┃     +     ┃     -     ┃     '     ┃   SPACE   ┃   ┃   SHIFT   ┃   Jeu 2   ┃   ENTER   ┃    WIN    ┃ ┃   Gaming  ┃ │  VOL+ │
// ╰───────╯ ┗━━━━━━━━━━━┛ ┗━━━━━━━━━━━┻━━━━━━━━━━━┻━━━━━━━━━━━┻━━━━━━━━━━━┛   ┗━━━━━━━━━━━┻━━━━━━━━━━━┻━━━━━━━━━━━┻━━━━━━━━━━━┛ ┗━━━━━━━━━━━┛ ╰───────╯
    &mt ESC TAB &kp _A      &kp _Z      &kp _E      &kp _R      &kp _T
    &kp TAB     &kp _Q      &kp _S      &kp _D      &kp _F      &kp _G
                &kp _W      &kp _X      &kp _C      &kp _V      &kp _B
            no___           &kp _PLUS   &kp _MINS   &kp _SQUO   &kp SPACE
                                                                                &kp _Y      &kp _U      &kp _I      &kp _O      &kp _P      &kp BSPC
                                                                                &kp _H      &kp _J      &kp _K      &kp _L      &kp _M      &kp DEL
                                                                                &kp _N      &comm_qmark &dot_excl   &semi_slsh  &colon_bsls
                                                                                &kp LSHIFT  &mo GAMING_2&kp ENTER   &kp LGUI    &gaming
, &inc_dec_kp C_VOL_DN C_VOL_UP                                                 &inc_dec_kp C_VOL_DN C_VOL_UP)

// Raccourcis de jeu Windows.
LAYER(GAMING_2,
// ┏━━━━━━━━━━━┳━━━━━━━━━━━┳━━━━━━━━━━━┳━━━━━━━━━━━┳━━━━━━━━━━━┳━━━━━━━━━━━┓   ┏━━━━━━━━━━━┳━━━━━━━━━━━┳━━━━━━━━━━━┳━━━━━━━━━━━┳━━━━━━━━━━━┳━━━━━━━━━━━┓
// ┃     ∅     ┃     ∅     ┃     ∅     ┃     ∅     ┃     ∅     ┃     ∅     ┃   ┃     "     ┃  CTRL+F1  ┃  CTRL+F2  ┃  CTRL+F3  ┃  CTRL+F4  ┃     ·     ┃
// ┣━━━━━━━━━━━╋━━━━━━━━━━━╋━━━━━━━━━━━╋━━━━━━━━━━━╋━━━━━━━━━━━╋━━━━━━━━━━━┫   ┣━━━━━━━━━━━╋━━━━━━━━━━━╋━━━━━━━━━━━╋━━━━━━━━━━━╋━━━━━━━━━━━╋━━━━━━━━━━━┫
// ┃     ·     ┃     ∅     ┃     ∅     ┃     ∅     ┃     ∅     ┃     ∅     ┃   ┃     '     ┃  CTRL+F5  ┃  CTRL+F6  ┃  CTRL+F7  ┃  CTRL+F8  ┃     ·     ┃
// ┗━━━━━━━━━━━╋━━━━━━━━━━━╋━━━━━━━━━━━╋━━━━━━━━━━━╋━━━━━━━━━━━╋━━━━━━━━━━━┫   ┣━━━━━━━━━━━╋━━━━━━━━━━━╋━━━━━━━━━━━╋━━━━━━━━━━━╋━━━━━━━━━━━╋━━━━━━━━━━━┛
//             ┃     ∅     ┃     ∅     ┃     ∅     ┃     ∅     ┃     ∅     ┃   ┃     `     ┃  CTRL+F9  ┃  CTRL+F10 ┃  CTRL+F11 ┃  CTRL+F12 ┃
// ╭───────╮   ┗━━━━━━━━━━━┻━━━━━━━━━━━┻━━━━━━━━━━━┻━━━━━━━━━━━┻━━━━━━━━━━━┛   ┗━━━━━━━━━━━┻━━━━━━━━━━━┻━━━━━━━━━━━┻━━━━━━━━━━━┻━━━━━━━━━━━┛   ╭───────╮
// │  VOL- │ ┏━━━━━━━━━━━┓ ┏━━━━━━━━━━━┳━━━━━━━━━━━┳━━━━━━━━━━━┳━━━━━━━━━━━┓   ┏━━━━━━━━━━━┳━━━━━━━━━━━┳━━━━━━━━━━━┳━━━━━━━━━━━┓ ┏━━━━━━━━━━━┓ │  VOL- │
// │  VOL+ │ ┃     ∅     ┃ ┃    CTRL   ┃    ALT    ┃     ∅     ┃     ·     ┃   ┃     ·     ┃     ·     ┃     ·     ┃     ·     ┃ ┃    Base   ┃ │  VOL+ │
// ╰───────╯ ┗━━━━━━━━━━━┛ ┗━━━━━━━━━━━┻━━━━━━━━━━━┻━━━━━━━━━━━┻━━━━━━━━━━━┛   ┗━━━━━━━━━━━┻━━━━━━━━━━━┻━━━━━━━━━━━┻━━━━━━━━━━━┛ ┗━━━━━━━━━━━┛ ╰───────╯
    no___       no___       no___       no___       no___       no___
    trs__       no___       no___       no___       no___       no___
                no___       no___       no___       no___       no___
            no___           &kp LCTRL   &kp LALT    no___       trs__
                                                                                &quot       &kp LC(F1)  &kp LC(F2)  &kp LC(F3)  &kp LC(F4)  trs__
                                                                                &squo       &kp LC(F5)  &kp LC(F6)  &kp LC(F7)  &kp LC(F8)  trs__
                                                                                &fr_grv     &kp LC(F9)  &kp LC(F10) &kp LC(F11) &kp LC(F12)
                                                                                trs__       trs__       trs__       trs__       &to BASE
, &inc_dec_kp C_VOL_DN C_VOL_UP                                                 &inc_dec_kp C_VOL_DN C_VOL_UP)
