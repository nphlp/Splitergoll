## config/west.yml
```yaml
# Dependency lock for ZMK v0.3.0. Every project uses an immutable commit ID.
# Resolved from app/west.yml and the pinned Zephyr manifest, including submanifests.
manifest:
  group-filter:
  - -babblesim
  - -optional
  projects:
  - name: zmk
    url: https://github.com/zmkfirmware/zmk
    revision: edf5c0814fd3ea202e43aad2d68fd32e882a518c
    west-commands: scripts/west-commands.yml
  - name: zephyr
    url: https://github.com/zmkfirmware/zephyr
    revision: dacab4875df72109b96cc8977547a0dc04875bcd
    west-commands: scripts/west-commands.yml
  - name: nanopb
    url: https://github.com/zmkfirmware/nanopb
    revision: 8c60555d6277a0360c876bd85d491fc4fb0cd74a
    path: modules/lib/nanopb
  - name: zmk-studio-messages
    url: https://github.com/zmkfirmware/zmk-studio-messages
    revision: 6cb4c283e76209d59c45fbcb218800cd19e9339d
    path: modules/msgs/zmk-studio-messages
  - name: acpica
    url: https://github.com/zephyrproject-rtos/acpica
    revision: 0333c2af13179f9b33d495cf7cb9a509f751cbb1
    path: modules/lib/acpica
  - name: bsim
    url: https://github.com/zephyrproject-rtos/babblesim-manifest
    revision: 384a091445c57b44ac8cbd18ebd245b47c71db94
    path: tools/bsim
    groups:
    - babblesim
  - name: babblesim_base
    url: https://github.com/BabbleSim/base.git
    revision: 19d62424c0802c6c9fc15528febe666e40f372a1
    path: tools/bsim/components
    groups:
    - babblesim
  - name: babblesim_ext_2G4_libPhyComv1
    url: https://github.com/BabbleSim/ext_2G4_libPhyComv1.git
    revision: 9018113a362fa6c9e8f4b9cab9e5a8f12cc46b94
    path: tools/bsim/components/ext_2G4_libPhyComv1
    groups:
    - babblesim
  - name: babblesim_ext_2G4_phy_v1
    url: https://github.com/BabbleSim/ext_2G4_phy_v1.git
    revision: d47c6dd90035b41b14f6921785ccb7b8484868e2
    path: tools/bsim/components/ext_2G4_phy_v1
    groups:
    - babblesim
  - name: babblesim_ext_2G4_channel_NtNcable
    url: https://github.com/BabbleSim/ext_2G4_channel_NtNcable.git
    revision: 20a38c997f507b0aa53817aab3d73a462fff7af1
    path: tools/bsim/components/ext_2G4_channel_NtNcable
    groups:
    - babblesim
  - name: babblesim_ext_2G4_channel_multiatt
    url: https://github.com/BabbleSim/ext_2G4_channel_multiatt.git
    revision: bde72a57384dde7a4310bcf3843469401be93074
    path: tools/bsim/components/ext_2G4_channel_multiatt
    groups:
    - babblesim
  - name: babblesim_ext_2G4_modem_magic
    url: https://github.com/BabbleSim/ext_2G4_modem_magic.git
    revision: cb70771794f0bf6f262aa474848611c68ae8f1ed
    path: tools/bsim/components/ext_2G4_modem_magic
    groups:
    - babblesim
  - name: babblesim_ext_2G4_modem_BLE_simple
    url: https://github.com/BabbleSim/ext_2G4_modem_BLE_simple.git
    revision: 809ab073159c9ab6686c2fea5749b0702e0909f7
    path: tools/bsim/components/ext_2G4_modem_BLE_simple
    groups:
    - babblesim
  - name: babblesim_ext_2G4_device_burst_interferer
    url: https://github.com/BabbleSim/ext_2G4_device_burst_interferer.git
    revision: 5b5339351d6e6a2368c686c734dc8b2fc65698fc
    path: tools/bsim/components/ext_2G4_device_burst_interferer
    groups:
    - babblesim
  - name: babblesim_ext_2G4_device_WLAN_actmod
    url: https://github.com/BabbleSim/ext_2G4_device_WLAN_actmod.git
    revision: 9cb6d8e72695f6b785e57443f0629a18069d6ce4
    path: tools/bsim/components/ext_2G4_device_WLAN_actmod
    groups:
    - babblesim
  - name: babblesim_ext_2G4_device_playback
    url: https://github.com/BabbleSim/ext_2G4_device_playback.git
    revision: 85c645929cf1ce995d8537107d9dcbd12ed64036
    path: tools/bsim/components/ext_2G4_device_playback
    groups:
    - babblesim
  - name: babblesim_ext_libCryptov1
    url: https://github.com/BabbleSim/ext_libCryptov1.git
    revision: eed6d7038e839153e340bd333bc43541cb90ba64
    path: tools/bsim/components/ext_libCryptov1
    groups:
    - babblesim
  - name: canopennode
    url: https://github.com/zephyrproject-rtos/canopennode
    revision: dec12fa3f0d790cafa8414a4c2930ea71ab72ffd
    path: modules/lib/canopennode
  - name: cmsis
    url: https://github.com/zephyrproject-rtos/cmsis
    revision: 5a00331455dd74e31e80efa383a489faea0590e3
    path: modules/hal/cmsis
    groups:
    - hal
  - name: cmsis-dsp
    url: https://github.com/zephyrproject-rtos/cmsis-dsp
    revision: ff7b5fd1ea5f094665c090c343ec44e74dc0b193
    path: modules/lib/cmsis-dsp
  - name: cmsis-nn
    url: https://github.com/zephyrproject-rtos/cmsis-nn
    revision: 0c8669d81381ccf3b1a01d699f3b68b50134a99f
    path: modules/lib/cmsis-nn
  - name: fatfs
    url: https://github.com/zephyrproject-rtos/fatfs
    revision: 427159bf95ea49b7680facffaa29ad506b42709b
    path: modules/fs/fatfs
    groups:
    - fs
  - name: hal_ambiq
    url: https://github.com/zephyrproject-rtos/hal_ambiq
    revision: 0a7c99325aa73a1ef777501da91c2c6608661e56
    path: modules/hal/ambiq
    groups:
    - hal
  - name: hal_atmel
    url: https://github.com/zephyrproject-rtos/hal_atmel
    revision: 5ab43007eda3f380c125f957f03638d2e8d1144d
    path: modules/hal/atmel
    groups:
    - hal
  - name: hal_espressif
    url: https://github.com/zephyrproject-rtos/hal_espressif
    revision: 31fc5758f3507f8f0af00b1dea1a0df7af99bfc0
    path: modules/hal/espressif
    west-commands: west/west-commands.yml
    groups:
    - hal
  - name: hal_ethos_u
    url: https://github.com/zephyrproject-rtos/hal_ethos_u
    revision: 90ada2ea5681b2a2722a10d2898eac34c2510791
    path: modules/hal/ethos_u
    groups:
    - hal
  - name: hal_gigadevice
    url: https://github.com/zephyrproject-rtos/hal_gigadevice
    revision: 2994b7dde8b0b0fa9b9c0ccb13474b6a486cddc3
    path: modules/hal/gigadevice
    groups:
    - hal
  - name: hal_intel
    url: https://github.com/zephyrproject-rtos/hal_intel
    revision: b3b43d4e3da7ba483611bbbea7ef8af92c69df31
    path: modules/hal/intel
    groups:
    - hal
  - name: hal_nordic
    url: https://github.com/zephyrproject-rtos/hal_nordic
    revision: 884c4d61746bc35fbd379c169fc87ddb56c6461d
    path: modules/hal/nordic
    groups:
    - hal
  - name: hal_nuvoton
    url: https://github.com/zephyrproject-rtos/hal_nuvoton
    revision: 3e0a4c4d3328b2f72b164219add19d5308b53cb5
    path: modules/hal/nuvoton
    groups:
    - hal
  - name: hal_quicklogic
    url: https://github.com/zephyrproject-rtos/hal_quicklogic
    revision: b3a66fe6d04d87fd1533a5c8de51d0599fcd08d0
    path: modules/hal/quicklogic
    groups:
    - hal
  - name: hal_renesas
    url: https://github.com/zephyrproject-rtos/hal_renesas
    revision: a6cf2af9140e014fbbc48d2b6deb802231dd369f
    path: modules/hal/renesas
    groups:
    - hal
  - name: hal_rpi_pico
    url: https://github.com/zephyrproject-rtos/hal_rpi_pico
    revision: fba7162cc7bee06d0149622bbcaac4e41062d368
    path: modules/hal/rpi_pico
    groups:
    - hal
  - name: hal_stm32
    url: https://github.com/zephyrproject-rtos/hal_stm32
    revision: 89ef0a3383edebf661073073bcdf6e2836fe90ee
    path: modules/hal/stm32
    groups:
    - hal
  - name: hal_telink
    url: https://github.com/zephyrproject-rtos/hal_telink
    revision: 38573af589173259801ae6c2b34b7d4c9e626746
    path: modules/hal/telink
    groups:
    - hal
  - name: hal_wurthelektronik
    url: https://github.com/zephyrproject-rtos/hal_wurthelektronik
    revision: 24ca9873c3d608fad1fea0431836bc8f144c132e
    path: modules/hal/wurthelektronik
    groups:
    - hal
  - name: libmetal
    url: https://github.com/zephyrproject-rtos/libmetal
    revision: b91611a6f47dd29fb24c46e5621e797557f80ec6
    path: modules/hal/libmetal
    groups:
    - hal
  - name: liblc3
    url: https://github.com/zephyrproject-rtos/liblc3
    revision: 448f3de31f49a838988a162ef1e23a89ddf2d2ed
    path: modules/lib/liblc3
  - name: littlefs
    url: https://github.com/zephyrproject-rtos/littlefs
    revision: ca583fd297ceb48bced3c2548600dc615d67af24
    path: modules/fs/littlefs
    groups:
    - fs
  - name: lvgl
    url: https://github.com/zephyrproject-rtos/lvgl
    revision: 8a6a2d1d29d17d1e4bdc94c243c146a39d635fdd
    path: modules/lib/gui/lvgl
  - name: mbedtls
    url: https://github.com/zephyrproject-rtos/mbedtls
    revision: c38dc78d9a8dcbe43b898cc1171ab33ba3e6fc26
    path: modules/crypto/mbedtls
    groups:
    - crypto
  - name: mipi-sys-t
    url: https://github.com/zephyrproject-rtos/mipi-sys-t
    revision: a819419603a2dfcb47f7f39092e1bc112e45d1ef
    path: modules/debug/mipi-sys-t
    groups:
    - debug
  - name: nrf_hw_models
    url: https://github.com/zephyrproject-rtos/nrf_hw_models
    revision: f4595802d32d103718bf50b3d390b7a450895843
    path: modules/bsim_hw_models/nrf_hw_models
  - name: open-amp
    url: https://github.com/zephyrproject-rtos/open-amp
    revision: 42b7c577714b8f22ce82a901e19c1814af4609a8
    path: modules/lib/open-amp
  - name: percepio
    url: https://github.com/zephyrproject-rtos/percepio
    revision: a3728efccc47dd372f40e6313589ca4c5cc7d5e9
    path: modules/debug/percepio
    groups:
    - debug
  - name: picolibc
    url: https://github.com/zephyrproject-rtos/picolibc
    revision: d07c38ff051386f8e09a143ea0a6c1d6d66dd1d8
    path: modules/lib/picolibc
  - name: segger
    url: https://github.com/zephyrproject-rtos/segger
    revision: 9d0191285956cef43daf411edc2f1a7788346def
    path: modules/debug/segger
    groups:
    - debug
  - name: tinycrypt
    url: https://github.com/zephyrproject-rtos/tinycrypt
    revision: 3e9a49d2672ec01435ffbf0d788db6d95ef28de0
    path: modules/crypto/tinycrypt
    groups:
    - crypto
  - name: trusted-firmware-a
    url: https://github.com/zephyrproject-rtos/trusted-firmware-a
    revision: 421dc050278287839f5c70019bd6aec617f2bbdb
    path: modules/tee/tf-a/trusted-firmware-a
    groups:
    - tee
  - name: uoscore-uedhoc
    url: https://github.com/zephyrproject-rtos/uoscore-uedhoc
    revision: 5fe2cb613bd7e4590bd1b00c2adf181ac0229379
    path: modules/lib/uoscore-uedhoc
  - name: zcbor
    url: https://github.com/zephyrproject-rtos/zcbor
    revision: 67fd8bb88d3136738661fa8bb5f9989103f4599e
    path: modules/lib/zcbor
  - name: chre
    url: https://github.com/zephyrproject-rtos/chre
    revision: 3b32c76efee705af146124fb4190f71be5a4e36e
    path: modules/lib/chre
    groups:
    - optional
  - name: lz4
    url: https://github.com/zephyrproject-rtos/lz4
    revision: 8e303c264fc21c2116dc612658003a22e933124d
    path: modules/lib/lz4
    groups:
    - optional
  - name: psa-arch-tests
    url: https://github.com/zephyrproject-rtos/psa-arch-tests
    revision: 6a17330e0dfb5f319730f974d5b05f7b7f04757b
    path: modules/tee/tf-m/psa-arch-tests
    groups:
    - optional
  - name: sof
    url: https://github.com/zephyrproject-rtos/sof
    revision: c0f20b69daa44e3563f970b366e49ccfcfa1b71c
    path: modules/audio/sof
    groups:
    - optional
  - name: tf-m-tests
    url: https://github.com/zephyrproject-rtos/tf-m-tests
    revision: a878426da78fbd1486dfc29d6c6b82be4ee79e72
    path: modules/tee/tf-m/tf-m-tests
    groups:
    - optional
  - name: tflite-micro
    url: https://github.com/zephyrproject-rtos/tflite-micro
    revision: 1a34dcab41e7e0e667db72d6a40999c1ec9c510c
    path: optional/modules/lib/tflite-micro
    groups:
    - optional
  - name: thrift
    url: https://github.com/zephyrproject-rtos/thrift
    revision: 10023645a0e6cb7ce23fcd7fd3dbac9f18df6234
    path: optional/modules/lib/thrift
    groups:
    - optional
  - name: zscilib
    url: https://github.com/zephyrproject-rtos/zscilib
    revision: 34c3432e81085bb717e4871d21ca419ae0058ec5
    path: modules/lib/zscilib
    groups:
    - optional
  self:
    path: config
```

## diagnostics/os-signature/firmware/Kconfig
```kconfig
# Options des diagnostics propres à Splitergoll, désactivées dans les builds usuels.
config SPLITERGOLL_USB_TRACE
    bool "Record USB setup requests on the diagnostic serial port"
    depends on USB_DEVICE_STACK && USB_CDC_ACM
    depends on ZMK_SPLIT_ROLE_CENTRAL
    default n

config SPLITERGOLL_BLE_TRACE
    bool "Record host BLE discovery on the diagnostic serial port"
    depends on BT && USB_DEVICE_STACK && USB_CDC_ACM
    depends on ZMK_SPLIT_ROLE_CENTRAL && !ZMK_USB
    depends on !SPLITERGOLL_USB_TRACE
    select BT_REMOTE_INFO
    select SPLITERGOLL_BLE_MEMORY
    default n
```

## keyboard/Kconfig
```kconfig
# Options locales du clavier, déduites de la keymap sélectionnée.
config SPLITERGOLL_BLE_MEMORY
    bool
    depends on BT && SETTINGS && BT_SETTINGS && ZMK_SPLIT_ROLE_CENTRAL
    depends on MBEDTLS_SHA256 && BT_SMP_SC_PAIR_ONLY
    depends on !BT_SIGNING && !BT_KEYS_OVERWRITE_OLDEST

config SPLITERGOLL_OS_AUTO
    bool
    default y if DT_HAS_SPLITERGOLL_OS_AUTO_ENABLED
    depends on ZMK_SPLIT_ROLE_CENTRAL && (ZMK_USB || ZMK_BLE)

config SPLITERGOLL_BLE_AUTO
    bool
    default y if SPLITERGOLL_OS_AUTO && !ZMK_USB
    depends on ZMK_BLE && !ZMK_USB && ZMK_SPLIT_ROLE_CENTRAL
    select SPLITERGOLL_BLE_MEMORY

config SPLITERGOLL_BLE_RECONNECT
    bool
    default y if SPLITERGOLL_BLE_AUTO
    depends on SPLITERGOLL_BLE_AUTO && !BT_EXT_ADV && BT_SMP_APP_PAIRING_ACCEPT
    select BT_FILTER_ACCEPT_LIST

config SPLITERGOLL_BLE_OBSERVER
    bool
    default y if SPLITERGOLL_BLE_MEMORY
    depends on BT && ZMK_SPLIT_ROLE_CENTRAL

config SPLITERGOLL_USB_OBSERVER
    bool
    default y if (SPLITERGOLL_OS_AUTO && ZMK_USB) || SPLITERGOLL_USB_TRACE
    depends on USB_DEVICE_STACK && ZMK_SPLIT_ROLE_CENTRAL

# Le socle ZMK_BLE reste nécessaire au split, les annonces hôtes sont filtrées au lien.
config SPLITERGOLL_WIRE_USB_ONLY
    bool "USB-only host output on the wire central"
    depends on ZMK_USB && ZMK_BLE && ZMK_SPLIT_BLE && ZMK_SPLIT_ROLE_CENTRAL
    depends on !SPLITERGOLL_BLE_RECONNECT && !BT_EXT_ADV && !LTO

config SPLITERGOLL_HOST_IDENTITY
    bool "Diagnostic host identity over vendor USB HID and encrypted BLE"
    depends on SPLITERGOLL_BLE_AUTO && ZMK_SPLIT_ROLE_CENTRAL && !ZMK_USB
    depends on !USB_DEVICE_STACK_NEXT && !ZMK_USB_LOGGING && !LTO
    depends on USB_DEVICE_STACK && USB_DEVICE_HID && CSPRNG_ENABLED
```

## keyboard/dts/bindings/behaviors/splitergoll,behavior-device-next.yaml
```yaml
description: Select the next connected host after keys and delayed behaviors finish
compatible: "splitergoll,behavior-device-next"
include: zero_param.yaml
```

## keyboard/dts/bindings/splitergoll,os-auto.yaml
```yaml
description: Automatic host selection between the fixed Windows and macOS keymaps
compatible: "splitergoll,os-auto"
properties:
  device-modifier-position:
    type: int
    description: Physical modifier position for host switching while the OS is unavailable
  device-next-position:
    type: int
    description: Physical encoder button position for host switching while the OS is unavailable
```

## keyboard/tests/zephyr/testcase.yaml
```yaml
tests:
  splitergoll.activity:
    platform_allow: qemu_cortex_m3
    integration_platforms:
      - qemu_cortex_m3
    tags:
      - activity
      - settings
    timeout: 30
```
