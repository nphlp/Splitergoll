// ZMK files
#include <behaviors.dtsi>
#include <dt-bindings/zmk/bt.h>
#include <dt-bindings/zmk/keys.h>
#include <dt-bindings/zmk/mouse.h>

// Includes
#include "function.h"
#include "layers.h"
#include "french_layout/windows.h"
#include "french_layout/linux.h"
#include "french_layout/macos.h"

// Symbols signification
// `+` means `double tap` or `tap dance`
// `→` means `hold tap`
// `ou` means `Shift + key`

// Alias
#define no___ &none
#define trs__  &trans


// ┏━━━━━━━━━━━━━━━━━━━━━━━━━━━━━━━━━━━━━━━━━━━━━━━━━━━━━━━━━━━━━━━━━━━━━━━━━━━━━━━━━━━━━━━━━━━━━━━━━━━━━━━━━━━━━━━━━━━━━━━━━━━━━━━━━━━━━━━━━━━━━━━━━━━┓
// ┃                                                                      Default                                                                      ┃
// ┗━━━━━━━━━━━━━━━━━━━━━━━━━━━━━━━━━━━━━━━━━━━━━━━━━━━━━━━━━━━━━━━━━━━━━━━━━━━━━━━━━━━━━━━━━━━━━━━━━━━━━━━━━━━━━━━━━━━━━━━━━━━━━━━━━━━━━━━━━━━━━━━━━━━┛

// Shift mod                                              |  Default  |   Shift    |
// ------------------------------------------------------ | --------- | ---------- |
MORPH(comm_qmark, LSFT, &kp _COMMA, &kp _QMARK)        // | ,         | ?          |
MORPH(dot_excl, LSFT, &kp _DOT, &kp _EXCL)             // | .         | !          |
MORPH(semi_slsh, LSFT, &kp _SEMI, &kp _SLASH)          // | ;         | /          |
MORPH(colon_bsls, LSFT, &kp _COLON, &kp _BSLASH)       // | :         | backslash  |
MORPH(shift_unlock, LSFT, &kp LSHIFT, &kt LSHIFT)      // | Shift     | Shft unlck |

// Tap dance                                                      |   1 tap   |  2 taps   |  3 taps   |
// -------------------------------------------------------------- | --------- | --------- | --------- |
TAP_DANCE_2(shift_lock, &shift_unlock, &kt LSHIFT)             // | Shift     | Shft lock |           |
TAP_DANCE_3(priSec, &mo PRIMARY, &mo SECONDARY, &to NUMPAD)    // | Primary   | Secondary |Numpad lock|
TAP_DANCE_2(secPri, &mo SECONDARY, &mo PRIMARY)                // | Secondary | Primary   |           |

/* Shortcuts
Basic usage
- `SHIFT` to shift layer
- `L1` to layer 1
- `L2` to layer 2

Combo usage
- `L1` + `L2` to layer 3

Alternative usage
- `L1` + `L1` to layer 2
- `L2` + `L2` to layer 1

Lock usage
- `SHIFT` + `SHIFT` to LOCK shift layer
- `SHIFT` to UNLOCK shift layer

- `L1` + `L1` + `L1` to LOCK numpad layer
- `L1` to UNLOCK numpad layer
*/

LAYER(WINDOWS,
// ┏━━━━━━━━━━━┳━━━━━━━━━━━┳━━━━━━━━━━━┳━━━━━━━━━━━┳━━━━━━━━━━━┳━━━━━━━━━━━┓   ┏━━━━━━━━━━━┳━━━━━━━━━━━┳━━━━━━━━━━━┳━━━━━━━━━━━┳━━━━━━━━━━━┳━━━━━━━━━━━┓
// ┃    ESC    ┃     A     ┃     Z     ┃     E     ┃     R     ┃     T     ┃   ┃     Y     ┃     U     ┃     I     ┃     O     ┃     P     ┃   BSPACE  ┃
// ┣━━━━━━━━━━━╋━━━━━━━━━━━╋━━━━━━━━━━━╋━━━━━━━━━━━╋━━━━━━━━━━━╋━━━━━━━━━━━┫   ┣━━━━━━━━━━━╋━━━━━━━━━━━╋━━━━━━━━━━━╋━━━━━━━━━━━╋━━━━━━━━━━━╋━━━━━━━━━━━┫
// ┃    TAB    ┃     Q     ┃     S     ┃     D     ┃     F     ┃     G     ┃   ┃     H     ┃     J     ┃     K     ┃     L     ┃     M     ┃    DEL    ┃
// ┗━━━━━━━━━━━╋━━━━━━━━━━━╋━━━━━━━━━━━╋━━━━━━━━━━━╋━━━━━━━━━━━╋━━━━━━━━━━━┫   ┣━━━━━━━━━━━╋━━━━━━━━━━━╋━━━━━━━━━━━╋━━━━━━━━━━━╋━━━━━━━━━━━╋━━━━━━━━━━━┛
//             ┃     W     ┃     X     ┃     C     ┃     V     ┃     B     ┃   ┃     N     ┃  , or ?   ┃  . or !   ┃  ; or /   ┃  : or \   ┃
// ╭───────╮   ┗━━━━━━━━━━━┻━━━━━━━━━━━┻━━━━━━━━━━━┻━━━━━━━━━━━┻━━━━━━━━━━━┛   ┗━━━━━━━━━━━┻━━━━━━━━━━━┻━━━━━━━━━━━┻━━━━━━━━━━━┻━━━━━━━━━━━┛   ╭───────╮
// │ VOL+  │ ┏━━━━━━━━━━━┓ ┏━━━━━━━━━━━┳━━━━━━━━━━━┳━━━━━━━━━━━┳━━━━━━━━━━━┓   ┏━━━━━━━━━━━┳━━━━━━━━━━━┳━━━━━━━━━━━┳━━━━━━━━━━━┓ ┏━━━━━━━━━━━┓ │ LEFT  │
// │ VOL-  │ ┃ Play→Mute ┃ ┃   CTRL    ┃    ALT    ┃     L2    ┃   SPACE   ┃   ┃SHIFT+LOCK ┃     L1    ┃   ENTER   ┃    WIN    ┃ ┃ "Windows" ┃ │ RIGHT │
// ╰───────╯ ┗━━━━━━━━━━━┛ ┗━━━━━━━━━━━┻━━━━━━━━━━━┻━━━━━━━━━━━┻━━━━━━━━━━━┛   ┗━━━━━━━━━━━┻━━━━━━━━━━━┻━━━━━━━━━━━┻━━━━━━━━━━━┛ ┗━━━━━━━━━━━┛ ╰───────╯
    &kp ESC     &kp _A      &kp _Z      &kp _E      &kp _R      &kp _T 
    &kp TAB     &kp _Q      &kp _S      &kp _D      &kp _F      &kp _G
                &kp _W      &kp _X      &kp _C      &kp _V      &kp _B
            &mt C_MUTE C_PP &kp LCTRL   &kp LALT    &secPri     &kp SPACE
                                                                                &kp _Y      &kp _U      &kp _I      &kp _O      &kp _P      &kp BSPC
                                                                                &kp _H      &kp _J      &kp _K      &kp _L      &kp _M      &kp DEL
                                                                                &kp _N      &comm_qmark &dot_excl   &semi_slsh  &colon_bsls
                                                                                &shift_lock &priSec     &kp ENTER   &kp LGUI    &win
// ┃           ┃           ┃           ┃           ┃           ┃           ┃   ┃           ┃           ┃           ┃           ┃           ┃           ┃
, &inc_dec_kp C_VOL_DN C_VOL_UP                                                 &inc_dec_kp LEFT RIGHT)

// Shift mod                                                   |  Default  |   Shift    |
// ----------------------------------------------------------- | --------- | ---------- |
MORPH(m_dot_excl, LSFT, &kp _DOT, &kp M_EXCL)               // | .         | !          |
MORPH(m_colon_bsls, LSFT, &kp _COLON, &kp M_BSLASH)         // | :         | backslash  |

LAYER(LINUX,
// ┏━━━━━━━━━━━┳━━━━━━━━━━━┳━━━━━━━━━━━┳━━━━━━━━━━━┳━━━━━━━━━━━┳━━━━━━━━━━━┓   ┏━━━━━━━━━━━┳━━━━━━━━━━━┳━━━━━━━━━━━┳━━━━━━━━━━━┳━━━━━━━━━━━┳━━━━━━━━━━━┓
// ┃           ┃           ┃           ┃           ┃           ┃           ┃   ┃           ┃           ┃           ┃           ┃           ┃           ┃
// ┣━━━━━━━━━━━╋━━━━━━━━━━━╋━━━━━━━━━━━╋━━━━━━━━━━━╋━━━━━━━━━━━╋━━━━━━━━━━━┫   ┣━━━━━━━━━━━╋━━━━━━━━━━━╋━━━━━━━━━━━╋━━━━━━━━━━━╋━━━━━━━━━━━╋━━━━━━━━━━━┫
// ┃           ┃           ┃           ┃           ┃           ┃           ┃   ┃           ┃           ┃           ┃           ┃           ┃           ┃
// ┗━━━━━━━━━━━╋━━━━━━━━━━━╋━━━━━━━━━━━╋━━━━━━━━━━━╋━━━━━━━━━━━╋━━━━━━━━━━━┫   ┣━━━━━━━━━━━╋━━━━━━━━━━━╋━━━━━━━━━━━╋━━━━━━━━━━━╋━━━━━━━━━━━╋━━━━━━━━━━━┛
//             ┃           ┃           ┃           ┃           ┃           ┃   ┃           ┃           ┃           ┃           ┃           ┃
// ╭───────╮   ┗━━━━━━━━━━━┻━━━━━━━━━━━┻━━━━━━━━━━━┻━━━━━━━━━━━┻━━━━━━━━━━━┛   ┗━━━━━━━━━━━┻━━━━━━━━━━━┻━━━━━━━━━━━┻━━━━━━━━━━━┻━━━━━━━━━━━┛   ╭───────╮
// │ VOL+  │ ┏━━━━━━━━━━━┓ ┏━━━━━━━━━━━┳━━━━━━━━━━━┳━━━━━━━━━━━┳━━━━━━━━━━━┓   ┏━━━━━━━━━━━┳━━━━━━━━━━━┳━━━━━━━━━━━┳━━━━━━━━━━━┓ ┏━━━━━━━━━━━┓ │ LEFT  │
// │ VOL-  │ ┃           ┃ ┃           ┃           ┃           ┃           ┃   ┃           ┃           ┃           ┃           ┃ ┃  "Linux"  ┃ │ RIGHT │
// ╰───────╯ ┗━━━━━━━━━━━┛ ┗━━━━━━━━━━━┻━━━━━━━━━━━┻━━━━━━━━━━━┻━━━━━━━━━━━┛   ┗━━━━━━━━━━━┻━━━━━━━━━━━┻━━━━━━━━━━━┻━━━━━━━━━━━┛ ┗━━━━━━━━━━━┛ ╰───────╯
    trs__       trs__       trs__       trs__       trs__       trs__
    trs__       trs__       trs__       trs__       trs__       trs__
                trs__       trs__       trs__       trs__       trs__
                trs__       trs__       trs__       trs__       trs__
                                                                                trs__       trs__       trs__       trs__       trs__       trs__
                                                                                trs__       trs__       trs__       trs__       trs__       trs__
                                                                                trs__       trs__       trs__       trs__       trs__
                                                                                trs__       trs__       trs__       trs__       &linux
// ┃           ┃           ┃           ┃           ┃           ┃           ┃   ┃           ┃           ┃           ┃           ┃           ┃           ┃
, &inc_dec_kp C_VOL_DN C_VOL_UP                                                 &inc_dec_kp LEFT RIGHT)

LAYER(MACOS,
// ┏━━━━━━━━━━━┳━━━━━━━━━━━┳━━━━━━━━━━━┳━━━━━━━━━━━┳━━━━━━━━━━━┳━━━━━━━━━━━┓   ┏━━━━━━━━━━━┳━━━━━━━━━━━┳━━━━━━━━━━━┳━━━━━━━━━━━┳━━━━━━━━━━━┳━━━━━━━━━━━┓
// ┃           ┃           ┃           ┃           ┃           ┃           ┃   ┃           ┃           ┃           ┃           ┃           ┃           ┃
// ┣━━━━━━━━━━━╋━━━━━━━━━━━╋━━━━━━━━━━━╋━━━━━━━━━━━╋━━━━━━━━━━━╋━━━━━━━━━━━┫   ┣━━━━━━━━━━━╋━━━━━━━━━━━╋━━━━━━━━━━━╋━━━━━━━━━━━╋━━━━━━━━━━━╋━━━━━━━━━━━┫
// ┃           ┃           ┃           ┃           ┃           ┃           ┃   ┃           ┃           ┃           ┃           ┃           ┃           ┃
// ┗━━━━━━━━━━━╋━━━━━━━━━━━╋━━━━━━━━━━━╋━━━━━━━━━━━╋━━━━━━━━━━━╋━━━━━━━━━━━┫   ┣━━━━━━━━━━━╋━━━━━━━━━━━╋━━━━━━━━━━━╋━━━━━━━━━━━╋━━━━━━━━━━━╋━━━━━━━━━━━┛
//             ┃           ┃           ┃           ┃           ┃           ┃   ┃           ┃           ┃  . or !   ┃           ┃  : or \   ┃
// ╭───────╮   ┗━━━━━━━━━━━┻━━━━━━━━━━━┻━━━━━━━━━━━┻━━━━━━━━━━━┻━━━━━━━━━━━┛   ┗━━━━━━━━━━━┻━━━━━━━━━━━┻━━━━━━━━━━━┻━━━━━━━━━━━┻━━━━━━━━━━━┛   ╭───────╮
// │ VOL+  │ ┏━━━━━━━━━━━┓ ┏━━━━━━━━━━━┳━━━━━━━━━━━┳━━━━━━━━━━━┳━━━━━━━━━━━┓   ┏━━━━━━━━━━━┳━━━━━━━━━━━┳━━━━━━━━━━━┳━━━━━━━━━━━┓ ┏━━━━━━━━━━━┓ │ LEFT  │
// │ VOL-  │ ┃           ┃ ┃  COMMAND  ┃  OPTION   ┃           ┃           ┃   ┃           ┃           ┃           ┃  CONTROL  ┃ ┃  "MacOS"  ┃ │ RIGHT │
// ╰───────╯ ┗━━━━━━━━━━━┛ ┗━━━━━━━━━━━┻━━━━━━━━━━━┻━━━━━━━━━━━┻━━━━━━━━━━━┛   ┗━━━━━━━━━━━┻━━━━━━━━━━━┻━━━━━━━━━━━┻━━━━━━━━━━━┛ ┗━━━━━━━━━━━┛ ╰───────╯
    trs__       trs__       trs__       trs__       trs__       trs__
    trs__       trs__       trs__       trs__       trs__       trs__
                trs__       trs__       trs__       trs__       trs__
                trs__       &kp M_CMD   &kp M_OPN   trs__       trs__
                                                                                trs__       trs__       trs__       trs__       trs__       trs__
                                                                                trs__       trs__       trs__       trs__       trs__       trs__
                                                                                trs__       trs__       &m_dot_excl trs__       &m_colon_bsls
                                                                                trs__       trs__       trs__       &kp M_CTL   &mac
// ┃           ┃           ┃           ┃           ┃           ┃           ┃   ┃           ┃           ┃           ┃           ┃           ┃           ┃
, &inc_dec_kp C_VOL_DN C_VOL_UP                                                 &inc_dec_kp LEFT RIGHT)


// ┏━━━━━━━━━━━━━━━━━━━━━━━━━━━━━━━━━━━━━━━━━━━━━━━━━━━━━━━━━━━━━━━━━━━━━━━━━━━━━━━━━━━━━━━━━━━━━━━━━━━━━━━━━━━━━━━━━━━━━━━━━━━━━━━━━━━━━━━━━━━━━━━━━━━┓
// ┃                                                                      Primary                                                                      ┃
// ┗━━━━━━━━━━━━━━━━━━━━━━━━━━━━━━━━━━━━━━━━━━━━━━━━━━━━━━━━━━━━━━━━━━━━━━━━━━━━━━━━━━━━━━━━━━━━━━━━━━━━━━━━━━━━━━━━━━━━━━━━━━━━━━━━━━━━━━━━━━━━━━━━━━━┛

// Shift mod to release default shift morph    |  Default  |   Shift    |
// ------------------------------------------- | --------- | ---------- |
MORPH(quot, LSFT, &kp _QUOT, &kp _QUOT)     // | "         | "          |
MORPH(squo, LSFT, &kp _SQUO, &kp _SQUO)     // | '         | '          |
MORPH(lpar, LSFT, &kp _LPAR, &kp _LPAR)     // | (         | (          |
MORPH(rpar, LSFT, &kp _RPAR, &kp _RPAR)     // | )         | )          |
MORPH(lacc, LSFT, &kp _LACC, &kp _LACC)     // | {         | {          |
MORPH(racc, LSFT, &kp _RACC, &kp _RACC)     // | }         | }          |
MORPH(lcro, LSFT, &kp _LCRO, &kp _LCRO)     // | [         | [          |
MORPH(rcro, LSFT, &kp _RCRO, &kp _RCRO)     // | ]         | ]          |
MORPH(lche, LSFT, &kp _LCHE, &kp _LCHE)     // | <         | <          |
MORPH(rche, LSFT, &kp _RCHE, &kp _RCHE)     // | >         | >          |
MORPH(hash, LSFT, &kp _HASH, &kp _HASH)     // | #         | #          |
MORPH(and, LSFT, &kp _AND, &kp _AND)        // | &         | &          |
MORPH(pipe, LSFT, &kp _PIPE, &kp _PIPE)     // | |         | |          |
MORPH(at, LSFT, &kp _AT, &kp _AT)           // | @         | @          |

// Alias
#define CLEFT LC(LEFT)
#define CRIGHT LC(RIGHT)
#define WCLEFT LG(LC(LEFT))
#define WCRIGHT LG(LC(RIGHT))
#define WCNEW LG(LC(D))
#define WCSHW LG(TAB)
#define WCDEL LG(LC(F4))

// Macros
MACRO_WRITE(win, &kp LS(_W) &kp _I &kp _N &kp _D &kp _O &kp _W &kp _S, &kp BSPC &kp BSPC &kp BSPC &kp BSPC &kp BSPC &kp BSPC &kp BSPC)

/* Shortcuts
- `L1` + `SHIFT²` + `←, ↑, ↓ or →` to select text
- `L1` + `ALT` + `↑ or ↓` to move up/down a row
- `L1` + `ALT` + `SHIFT` + `↑ or ↓` to duplicate a row
- `L1` + `ALT` + `CTRL` + `↑ or ↓` to create multiline cursor
*/

LAYER(PRIMARY,
// ┏━━━━━━━━━━━┳━━━━━━━━━━━┳━━━━━━━━━━━┳━━━━━━━━━━━┳━━━━━━━━━━━┳━━━━━━━━━━━┓   ┏━━━━━━━━━━━┳━━━━━━━━━━━┳━━━━━━━━━━━┳━━━━━━━━━━━┳━━━━━━━━━━━┳━━━━━━━━━━━┓
// ┃           ┃           ┃  L Ligne  ┃           ┃  R Ligne  ┃           ┃   ┃     "     ┃     (     ┃     )     ┃     [     ┃     ]     ┃           ┃
// ┣━━━━━━━━━━━╋━━━━━━━━━━━╋━━━━━━━━━━━╋━━━━━━━━━━━╋━━━━━━━━━━━╋━━━━━━━━━━━┫   ┣━━━━━━━━━━━╋━━━━━━━━━━━╋━━━━━━━━━━━╋━━━━━━━━━━━╋━━━━━━━━━━━╋━━━━━━━━━━━┫
// ┃           ┃           ┃     ←     ┃     ↑     ┃     →     ┃     ->    ┃   ┃     '     ┃     {     ┃     }     ┃     <     ┃     >     ┃           ┃
// ┗━━━━━━━━━━━╋━━━━━━━━━━━╋━━━━━━━━━━━╋━━━━━━━━━━━╋━━━━━━━━━━━╋━━━━━━━━━━━┫   ┣━━━━━━━━━━━╋━━━━━━━━━━━╋━━━━━━━━━━━╋━━━━━━━━━━━╋━━━━━━━━━━━╋━━━━━━━━━━━┛
//             ┃           ┃  L Word   ┃     ↓     ┃  R Word   ┃     =>    ┃   ┃     `     ┃     #     ┃     &     ┃     |     ┃     @     ┃
// ╭───────╮   ┗━━━━━━━━━━━┻━━━━━━━━━━━┻━━━━━━━━━━━┻━━━━━━━━━━━┻━━━━━━━━━━━┛   ┗━━━━━━━━━━━┻━━━━━━━━━━━┻━━━━━━━━━━━┻━━━━━━━━━━━┻━━━━━━━━━━━┛   ╭───────╮
// │ LEFT  │ ┏━━━━━━━━━━━┓ ┏━━━━━━━━━━━┳━━━━━━━━━━━┳━━━━━━━━━━━┳━━━━━━━━━━━┓   ┏━━━━━━━━━━━┳━━━━━━━━━━━┳━━━━━━━━━━━┳━━━━━━━━━━━┓ ┏━━━━━━━━━━━┓ │ UP    │
// │ RIGHT │ ┃           ┃ ┃           ┃           ┃           ┃   SHIFT²  ┃   ┃   SHIFT   ┃     L1    ┃           ┃           ┃ ┃ To Linux  ┃ │ DOWN  │
// ╰───────╯ ┗━━━━━━━━━━━┛ ┗━━━━━━━━━━━┻━━━━━━━━━━━┻━━━━━━━━━━━┻━━━━━━━━━━━┛   ┗━━━━━━━━━━━┻━━━━━━━━━━━┻━━━━━━━━━━━┻━━━━━━━━━━━┛ ┗━━━━━━━━━━━┛ ╰───────╯
    no___       no___       &kp HOME    no___       &kp END     no___
    no___       no___       &kp LEFT    &kp UP      &kp RIGHT   &fr_arw_s
                no___       &kp CLEFT   &kp DOWN    &kp CRIGHT  &fr_arw_d
                no___       trs__       trs__       trs__       &kp LSHIFT
                                                                                &quot       &lpar       &rpar       &lcro       &rcro      trs__
                                                                                &squo       &lacc       &racc       &lche       &rche      trs__
                                                                                &fr_grv     &hash       &and        &pipe       &at
                                                                                &kp LSHIFT  trs__       trs__       trs__       &to LINUX
// ┃           ┃           ┃           ┃           ┃           ┃           ┃   ┃           ┃           ┃           ┃           ┃           ┃           ┃
, &inc_dec_kp LEFT RIGHT                                                        &inc_dec_kp UP DOWN)

// Macros
MACRO_WRITE(linux, &kp LS(_L) &kp _I &kp _N &kp _U &kp _X, &kp BSPC &kp BSPC &kp BSPC &kp BSPC &kp BSPC)

LAYER(PRIMARY_LINUX,
// ┏━━━━━━━━━━━┳━━━━━━━━━━━┳━━━━━━━━━━━┳━━━━━━━━━━━┳━━━━━━━━━━━┳━━━━━━━━━━━┓   ┏━━━━━━━━━━━┳━━━━━━━━━━━┳━━━━━━━━━━━┳━━━━━━━━━━━┳━━━━━━━━━━━┳━━━━━━━━━━━┓
// ┃           ┃           ┃           ┃           ┃           ┃           ┃   ┃           ┃           ┃           ┃           ┃           ┃           ┃
// ┣━━━━━━━━━━━╋━━━━━━━━━━━╋━━━━━━━━━━━╋━━━━━━━━━━━╋━━━━━━━━━━━╋━━━━━━━━━━━┫   ┣━━━━━━━━━━━╋━━━━━━━━━━━╋━━━━━━━━━━━╋━━━━━━━━━━━╋━━━━━━━━━━━╋━━━━━━━━━━━┫
// ┃           ┃           ┃           ┃           ┃           ┃           ┃   ┃           ┃           ┃           ┃           ┃           ┃           ┃
// ┗━━━━━━━━━━━╋━━━━━━━━━━━╋━━━━━━━━━━━╋━━━━━━━━━━━╋━━━━━━━━━━━╋━━━━━━━━━━━┫   ┣━━━━━━━━━━━╋━━━━━━━━━━━╋━━━━━━━━━━━╋━━━━━━━━━━━╋━━━━━━━━━━━╋━━━━━━━━━━━┛
//             ┃           ┃           ┃           ┃           ┃           ┃   ┃     `     ┃           ┃           ┃           ┃           ┃
// ╭───────╮   ┗━━━━━━━━━━━┻━━━━━━━━━━━┻━━━━━━━━━━━┻━━━━━━━━━━━┻━━━━━━━━━━━┛   ┗━━━━━━━━━━━┻━━━━━━━━━━━┻━━━━━━━━━━━┻━━━━━━━━━━━┻━━━━━━━━━━━┛   ╭───────╮
// │ LEFT  │ ┏━━━━━━━━━━━┓ ┏━━━━━━━━━━━┳━━━━━━━━━━━┳━━━━━━━━━━━┳━━━━━━━━━━━┓   ┏━━━━━━━━━━━┳━━━━━━━━━━━┳━━━━━━━━━━━┳━━━━━━━━━━━┓ ┏━━━━━━━━━━━┓ │ UP    │
// │ RIGHT │ ┃           ┃ ┃           ┃           ┃           ┃           ┃   ┃           ┃           ┃           ┃           ┃ ┃ To MacOS  ┃ │ DOWN  │
// ╰───────╯ ┗━━━━━━━━━━━┛ ┗━━━━━━━━━━━┻━━━━━━━━━━━┻━━━━━━━━━━━┻━━━━━━━━━━━┛   ┗━━━━━━━━━━━┻━━━━━━━━━━━┻━━━━━━━━━━━┻━━━━━━━━━━━┛ ┗━━━━━━━━━━━┛ ╰───────╯
    trs__       trs__       trs__       trs__       trs__       trs__
    trs__       trs__       trs__       trs__       trs__       trs__
                trs__       trs__       trs__       trs__       trs__
                trs__       trs__       trs__       trs__       trs__
                                                                                trs__       trs__       trs__       trs__       trs__       trs__
                                                                                trs__       trs__       trs__       trs__       trs__       trs__
                                                                                &kp L_GRV   trs__       trs__       trs__       trs__
                                                                                trs__       trs__       trs__       trs__       &to MACOS
// ┃           ┃           ┃           ┃           ┃           ┃           ┃   ┃           ┃           ┃           ┃           ┃           ┃           ┃
, &inc_dec_kp LEFT RIGHT                                                        &inc_dec_kp UP DOWN)

// Macros
MACRO_WRITE(mac, &kp LS(_M) &kp _A &kp _C &kp LS(_O) &kp LS(_S), &kp BSPC &kp BSPC &kp BSPC &kp BSPC &kp BSPC)

LAYER(PRIMARY_MACOS,
// ┏━━━━━━━━━━━┳━━━━━━━━━━━┳━━━━━━━━━━━┳━━━━━━━━━━━┳━━━━━━━━━━━┳━━━━━━━━━━━┓   ┏━━━━━━━━━━━┳━━━━━━━━━━━┳━━━━━━━━━━━┳━━━━━━━━━━━┳━━━━━━━━━━━┳━━━━━━━━━━━┓
// ┃           ┃           ┃  L Ligne  ┃           ┃  R Ligne  ┃           ┃   ┃           ┃           ┃           ┃     [     ┃     ]     ┃           ┃
// ┣━━━━━━━━━━━╋━━━━━━━━━━━╋━━━━━━━━━━━╋━━━━━━━━━━━╋━━━━━━━━━━━╋━━━━━━━━━━━┫   ┣━━━━━━━━━━━╋━━━━━━━━━━━╋━━━━━━━━━━━╋━━━━━━━━━━━╋━━━━━━━━━━━╋━━━━━━━━━━━┫
// ┃           ┃           ┃           ┃           ┃           ┃     ->    ┃   ┃           ┃     {     ┃     }     ┃     <     ┃     >     ┃           ┃
// ┗━━━━━━━━━━━╋━━━━━━━━━━━╋━━━━━━━━━━━╋━━━━━━━━━━━╋━━━━━━━━━━━╋━━━━━━━━━━━┫   ┣━━━━━━━━━━━╋━━━━━━━━━━━╋━━━━━━━━━━━╋━━━━━━━━━━━╋━━━━━━━━━━━╋━━━━━━━━━━━┛
//             ┃           ┃  L Word   ┃           ┃  R Word   ┃     =>    ┃   ┃     `     ┃     #     ┃           ┃     |     ┃     @     ┃
// ╭───────╮   ┗━━━━━━━━━━━┻━━━━━━━━━━━┻━━━━━━━━━━━┻━━━━━━━━━━━┻━━━━━━━━━━━┛   ┗━━━━━━━━━━━┻━━━━━━━━━━━┻━━━━━━━━━━━┻━━━━━━━━━━━┻━━━━━━━━━━━┛   ╭───────╮
// │ LEFT  │ ┏━━━━━━━━━━━┓ ┏━━━━━━━━━━━┳━━━━━━━━━━━┳━━━━━━━━━━━┳━━━━━━━━━━━┓   ┏━━━━━━━━━━━┳━━━━━━━━━━━┳━━━━━━━━━━━┳━━━━━━━━━━━┓ ┏━━━━━━━━━━━┓ │ UP    │
// │ RIGHT │ ┃           ┃ ┃  COMMAND  ┃  OPTION   ┃           ┃           ┃   ┃           ┃     L1    ┃           ┃  CONTROL  ┃ ┃ To Windows┃ │ DOWN  │
// ╰───────╯ ┗━━━━━━━━━━━┛ ┗━━━━━━━━━━━┻━━━━━━━━━━━┻━━━━━━━━━━━┻━━━━━━━━━━━┛   ┗━━━━━━━━━━━┻━━━━━━━━━━━┻━━━━━━━━━━━┻━━━━━━━━━━━┛ ┗━━━━━━━━━━━┛ ╰───────╯
    trs__       trs__       &kp M_HOME  trs__       &kp M_END   trs__
    trs__       trs__       trs__       trs__       trs__       &m_arw_s
                trs__       &kp M_LWRD  trs__       &kp M_RWRD  &m_arw_d
                trs__       &kp M_CMD   &kp M_OPN   trs__       trs__
                                                                                trs__       trs__       trs__       &kp M_LCRO  &kp M_RCRO  trs__
                                                                                trs__       &kp M_LACC  &kp M_RACC  &kp M_LCHE  &kp M_RCHE  trs__
                                                                                &m_grv      &kp M_HASH  trs__       &kp M_PIPE  &kp M_AT
                                                                                trs__       trs__       trs__       &kp M_CTL   &to WINDOWS
// ┃           ┃           ┃           ┃           ┃           ┃           ┃   ┃           ┃           ┃           ┃           ┃           ┃           ┃
, &inc_dec_kp LEFT RIGHT                                                        &inc_dec_kp UP DOWN)


// ┏━━━━━━━━━━━━━━━━━━━━━━━━━━━━━━━━━━━━━━━━━━━━━━━━━━━━━━━━━━━━━━━━━━━━━━━━━━━━━━━━━━━━━━━━━━━━━━━━━━━━━━━━━━━━━━━━━━━━━━━━━━━━━━━━━━━━━━━━━━━━━━━━━━━┓
// ┃                                                                     Secondary                                                                     ┃
// ┗━━━━━━━━━━━━━━━━━━━━━━━━━━━━━━━━━━━━━━━━━━━━━━━━━━━━━━━━━━━━━━━━━━━━━━━━━━━━━━━━━━━━━━━━━━━━━━━━━━━━━━━━━━━━━━━━━━━━━━━━━━━━━━━━━━━━━━━━━━━━━━━━━━━┛

// Shift mod to release default shift morph    |  Default  |   Shift    |
// ------------------------------------------- | --------- | ---------- |
MORPH(plus, LSFT, &kp _PLUS, &kp _PLUS)     // | +         | +          |
MORPH(mins, LSFT, &kp _MINS, &kp _MINS)     // | -         | -          |
MORPH(astr, LSFT, &kp _ASTR, &kp _ASTR)     // | *         | *          |
MORPH(divi, LSFT, &kp _DIVI, &kp _DIVI)     // | /         | /          |
MORPH(eqal, LSFT, &kp _EQAL, &kp _EQAL)     // | =         | =          |
MORPH(udsc, LSFT, &kp _UDSC, &kp _UDSC)     // | _         | _          |
MORPH(dolr, LSFT, &kp _DOLR, &kp _DOLR)     // | $         | $          |
MORPH(perc, LSFT, &kp _PERC, &kp _PERC)     // | %         | %          |
MORPH(n_dt, LSFT, &kp KP_DOT, &kp KP_DOT)   // | .         | .          |
MORPH(n_0, LSFT, &kp _0, &kp _0)            // | 0         | 0          |
MORPH(n_1, LSFT, &kp _1, &kp _1)            // | 1         | 1          |
MORPH(n_2, LSFT, &kp _2, &kp _2)            // | 2         | 2          |
MORPH(n_3, LSFT, &kp _3, &kp _3)            // | 3         | 3          |
MORPH(n_4, LSFT, &kp _4, &kp _4)            // | 4         | 4          |
MORPH(n_5, LSFT, &kp _5, &kp _5)            // | 5         | 5          |
MORPH(n_6, LSFT, &kp _6, &kp _6)            // | 6         | 6          |
MORPH(n_7, LSFT, &kp _7, &kp _7)            // | 7         | 7          |
MORPH(n_8, LSFT, &kp _8, &kp _8)            // | 8         | 8          |
MORPH(n_9, LSFT, &kp _9, &kp _9)            // | 9         | 9          |

// Tap dance                                                |   1 tap   |   2 taps   |   3 taps   |
// -------------------------------------------------------- | --------- | ---------- | ---------- |
TAP_DANCE_3(ag_agu_ac, &kp _AG,  &fr_ac, &fr_agu)        // | à         | â          | À          |
TAP_DANCE_2(cc_ccu,    &kp _CC,   &fr_ccu)               // | ç         | Ç          |            |
TAP_DANCE_2(ea_eau,    &kp _EA,  &fr_eau)                // | é         | É          |            |
TAP_DANCE_2(ec_ecu,    &fr_ec,  &fr_ecu)                 // | ê         | Ê          |            |
TAP_DANCE_2(eg_et,     &kp _EG,   &fr_et)                // | è         | ë          |            |
TAP_DANCE_3(ug_uc,     &kp _UG,   &fr_uc,   &kp _MU)     // | ù         | û          | μ          |
TAP_DANCE_2(ic_it,     &fr_ic,   &fr_it)                 // | î         | ï          |            |
TAP_DANCE_2(oc_ocu,    &fr_oc,   &fr_ocu)                // | ô         | Ô          |            |
TAP_DANCE_2(oe_oeu,    &fr_oe,   &fr_oeu)                // | œ         | Œ          |            |
TAP_DANCE_2(eu_li,    &kp _EURO, &kp _PND)               // | €         | £          |            |
TAP_DANCE_3(nb_2_3,   &kp _NUMB, &kp _EX2, &fr_ex3)      // | °         | ²          | ³          |

/* "Left hand onto keyboard + Right hand onto mouse" shortcuts
Common use case:
- `L2` + `CTRL` + `+` to zoom in
- `L2` + `CTRL` + `-` to zoom out
- `L2` + `SPACE` to space, useful with numpad

Left hand on keyboard, and right hand on mouse:
- `L2` + `CTRL` + `/` to comment/uncomment (add it to VSCode settings)
- `L2` + `ENTER` to return
- `L2` + `BSPACE` to backspace
- `L2` + `DEL` to delete
*/

LAYER(SECONDARY,
// ┏━━━━━━━━━━━┳━━━━━━━━━━━┳━━━━━━━━━━━┳━━━━━━━━━━━┳━━━━━━━━━━━┳━━━━━━━━━━━┓   ┏━━━━━━━━━━━┳━━━━━━━━━━━┳━━━━━━━━━━━┳━━━━━━━━━━━┳━━━━━━━━━━━┳━━━━━━━━━━━┓
// ┃   BSPACE  ┃   œ + Œ   ┃ ° + ² + ³ ┃     _     ┃     -     ┃     +     ┃   ┃     =     ┃     7     ┃     8     ┃     9     ┃   € + £   ┃           ┃
// ┣━━━━━━━━━━━╋━━━━━━━━━━━╋━━━━━━━━━━━╋━━━━━━━━━━━╋━━━━━━━━━━━╋━━━━━━━━━━━┫   ┣━━━━━━━━━━━╋━━━━━━━━━━━╋━━━━━━━━━━━╋━━━━━━━━━━━╋━━━━━━━━━━━╋━━━━━━━━━━━┫
// ┃    DEL    ┃   ô + Ô   ┃   é + É   ┃   ê + Ê   ┃   è + ë   ┃     *     ┃   ┃     0     ┃     4     ┃     5     ┃     6     ┃     $     ┃           ┃
// ┗━━━━━━━━━━━╋━━━━━━━━━━━╋━━━━━━━━━━━╋━━━━━━━━━━━╋━━━━━━━━━━━╋━━━━━━━━━━━┫   ┣━━━━━━━━━━━╋━━━━━━━━━━━╋━━━━━━━━━━━╋━━━━━━━━━━━╋━━━━━━━━━━━╋━━━━━━━━━━━┛
//             ┃   î + ï   ┃ ù + û + μ ┃   ç + Ç   ┃ à + â + À ┃     /     ┃   ┃     .     ┃     1     ┃     2     ┃     3     ┃     %     ┃
// ╭───────╮   ┗━━━━━━━━━━━┻━━━━━━━━━━━┻━━━━━━━━━━━┻━━━━━━━━━━━┻━━━━━━━━━━━┛   ┗━━━━━━━━━━━┻━━━━━━━━━━━┻━━━━━━━━━━━┻━━━━━━━━━━━┻━━━━━━━━━━━┛   ╭───────╮
// │ LEFT  │ ┏━━━━━━━━━━━┓ ┏━━━━━━━━━━━┳━━━━━━━━━━━┳━━━━━━━━━━━┳━━━━━━━━━━━┓   ┏━━━━━━━━━━━┳━━━━━━━━━━━┳━━━━━━━━━━━┳━━━━━━━━━━━┓ ┏━━━━━━━━━━━┓ │ UP    │
// │ RIGHT │ ┃           ┃ ┃           ┃           ┃     L2    ┃   ENTER   ┃   ┃   SPACE   ┃           ┃           ┃           ┃ ┃           ┃ │ DOWN  │
// ╰───────╯ ┗━━━━━━━━━━━┛ ┗━━━━━━━━━━━┻━━━━━━━━━━━┻━━━━━━━━━━━┻━━━━━━━━━━━┛   ┗━━━━━━━━━━━┻━━━━━━━━━━━┻━━━━━━━━━━━┻━━━━━━━━━━━┛ ┗━━━━━━━━━━━┛ ╰───────╯
    &kp BSPC    &oe_oeu     &nb_2_3     &udsc       &mins       &plus
    &kp DEL     &oc_ocu     &ea_eau     &ec_ecu     &eg_et      &astr
                &ic_it      &ug_uc      &cc_ccu     &ag_agu_ac  &divi
                no___       trs__       trs__       trs__       &kp ENTER
                                                                                &eqal       &n_7        &n_8        &n_9        &eu_li      trs__
                                                                                &n_0        &n_4        &n_5        &n_6        &dolr       trs__
                                                                                &n_dt       &n_1        &n_2        &n_3        &perc
                                                                                &kp SPACE   trs__       trs__       trs__       no___
// ┃           ┃           ┃           ┃           ┃           ┃           ┃   ┃           ┃           ┃           ┃           ┃           ┃           ┃
, &inc_dec_kp LEFT RIGHT                                                        &inc_dec_kp UP DOWN)

// Tap dance                                                |   1 tap   |   2 taps   |   3 taps   |
// -------------------------------------------------------- | --------- | ---------- | ---------- |
TAP_DANCE_3(l_ag_agu_ac,  &kp _AG,   &fr_ac, &kp L_AGU)  // | à         | â          | À          |
TAP_DANCE_2(l_ea_eau,     &kp _EA,   &kp L_EAU)          // | é         | É          |            |
TAP_DANCE_2(l_cc_ccu,   &kp _CC,   &kp L_CCU)            // | ç         | Ç          |            |
TAP_DANCE_2(l_oe_oeu,   &kp L_OE,  &kp L_OEU)            // | œ         | Œ          |            |
TAP_DANCE_3(l_nb_2_3,   &kp _NUMB, &kp _EX2, &kp L_EX3)  // | °         | ²          | ³          |

LAYER(SECONDARY_LINUX,
// ┏━━━━━━━━━━━┳━━━━━━━━━━━┳━━━━━━━━━━━┳━━━━━━━━━━━┳━━━━━━━━━━━┳━━━━━━━━━━━┓   ┏━━━━━━━━━━━┳━━━━━━━━━━━┳━━━━━━━━━━━┳━━━━━━━━━━━┳━━━━━━━━━━━┳━━━━━━━━━━━┓
// ┃           ┃   œ + Œ   ┃ ° + ² + ³ ┃           ┃           ┃           ┃   ┃           ┃           ┃           ┃           ┃           ┃           ┃
// ┣━━━━━━━━━━━╋━━━━━━━━━━━╋━━━━━━━━━━━╋━━━━━━━━━━━╋━━━━━━━━━━━╋━━━━━━━━━━━┫   ┣━━━━━━━━━━━╋━━━━━━━━━━━╋━━━━━━━━━━━╋━━━━━━━━━━━╋━━━━━━━━━━━╋━━━━━━━━━━━┫
// ┃           ┃           ┃   é + É   ┃           ┃           ┃           ┃   ┃           ┃           ┃           ┃           ┃           ┃           ┃
// ┗━━━━━━━━━━━╋━━━━━━━━━━━╋━━━━━━━━━━━╋━━━━━━━━━━━╋━━━━━━━━━━━╋━━━━━━━━━━━┫   ┣━━━━━━━━━━━╋━━━━━━━━━━━╋━━━━━━━━━━━╋━━━━━━━━━━━╋━━━━━━━━━━━╋━━━━━━━━━━━┛
//             ┃           ┃           ┃   ç + Ç   ┃ à + â + À ┃           ┃   ┃           ┃           ┃           ┃           ┃           ┃
// ╭───────╮   ┗━━━━━━━━━━━┻━━━━━━━━━━━┻━━━━━━━━━━━┻━━━━━━━━━━━┻━━━━━━━━━━━┛   ┗━━━━━━━━━━━┻━━━━━━━━━━━┻━━━━━━━━━━━┻━━━━━━━━━━━┻━━━━━━━━━━━┛   ╭───────╮
// │ LEFT  │ ┏━━━━━━━━━━━┓ ┏━━━━━━━━━━━┳━━━━━━━━━━━┳━━━━━━━━━━━┳━━━━━━━━━━━┓   ┏━━━━━━━━━━━┳━━━━━━━━━━━┳━━━━━━━━━━━┳━━━━━━━━━━━┓ ┏━━━━━━━━━━━┓ │ UP    │
// │ RIGHT │ ┃           ┃ ┃           ┃           ┃           ┃           ┃   ┃           ┃           ┃           ┃           ┃ ┃           ┃ │ DOWN  │
// ╰───────╯ ┗━━━━━━━━━━━┛ ┗━━━━━━━━━━━┻━━━━━━━━━━━┻━━━━━━━━━━━┻━━━━━━━━━━━┛   ┗━━━━━━━━━━━┻━━━━━━━━━━━┻━━━━━━━━━━━┻━━━━━━━━━━━┛ ┗━━━━━━━━━━━┛ ╰───────╯
    trs__       &l_oe_oeu   &l_nb_2_3   trs__       trs__       trs__
    trs__       trs__       &l_ea_eau   trs__       trs__       trs__
                trs__       trs__       &l_cc_ccu  &l_ag_agu_ac trs__
                trs__       trs__       trs__       trs__       trs__
                                                                                trs__       trs__       trs__       trs__       trs__       trs__
                                                                                trs__       trs__       trs__       trs__       trs__       trs__
                                                                                trs__       trs__       trs__       trs__       trs__
                                                                                trs__       trs__       trs__       trs__       trs__
// ┃           ┃           ┃           ┃           ┃           ┃           ┃   ┃           ┃           ┃           ┃           ┃           ┃           ┃
, &inc_dec_kp LEFT RIGHT                                                        &inc_dec_kp UP DOWN)

// Tap dance                                                 |   1 tap   |   2 taps   |   3 taps   |
// --------------------------------------------------------- | --------- | ---------- | ---------- |
TAP_DANCE_2(m_eu_li,     &kp M_EURO, &kp M_PND          ) // | €         | £          |            |
TAP_DANCE_3(m_ag_agu_ac, &kp _AG,    &fr_ac,   &m_agu   ) // | à         | â          | À          |
TAP_DANCE_2(m_cc_ccu,    &kp _CC,    &kp M_CCU          ) // | ç         | Ç          |            |
TAP_DANCE_2(m_ea_eau,    &kp _EA,    &m_eau             ) // | é         | É          |            |
TAP_DANCE_3(m_ug_uc,     &kp _UG,    &fr_uc,   &kp M_MU ) // | ù         | û          | μ          |
TAP_DANCE_2(m_oe_oeu,    &kp M_OE,   &kp M_OEU          ) // | œ         | Œ          |            |

LAYER(SECONDARY_MACOS,
// ┏━━━━━━━━━━━┳━━━━━━━━━━━┳━━━━━━━━━━━┳━━━━━━━━━━━┳━━━━━━━━━━━┳━━━━━━━━━━━┓   ┏━━━━━━━━━━━┳━━━━━━━━━━━┳━━━━━━━━━━━┳━━━━━━━━━━━┳━━━━━━━━━━━┳━━━━━━━━━━━┓
// ┃           ┃   œ + Œ   ┃     °     ┃     _     ┃     -     ┃     +     ┃   ┃     =     ┃           ┃           ┃           ┃   € + £   ┃           ┃
// ┣━━━━━━━━━━━╋━━━━━━━━━━━╋━━━━━━━━━━━╋━━━━━━━━━━━╋━━━━━━━━━━━╋━━━━━━━━━━━┫   ┣━━━━━━━━━━━╋━━━━━━━━━━━╋━━━━━━━━━━━╋━━━━━━━━━━━╋━━━━━━━━━━━╋━━━━━━━━━━━┫
// ┃           ┃           ┃   é + É   ┃           ┃           ┃           ┃   ┃           ┃           ┃           ┃           ┃     $     ┃           ┃
// ┗━━━━━━━━━━━╋━━━━━━━━━━━╋━━━━━━━━━━━╋━━━━━━━━━━━╋━━━━━━━━━━━╋━━━━━━━━━━━┫   ┣━━━━━━━━━━━╋━━━━━━━━━━━╋━━━━━━━━━━━╋━━━━━━━━━━━╋━━━━━━━━━━━╋━━━━━━━━━━━┛
//             ┃           ┃ ù + û + μ ┃   ç + Ç   ┃ à + â + À ┃           ┃   ┃     .     ┃           ┃           ┃           ┃           ┃
// ╭───────╮   ┗━━━━━━━━━━━┻━━━━━━━━━━━┻━━━━━━━━━━━┻━━━━━━━━━━━┻━━━━━━━━━━━┛   ┗━━━━━━━━━━━┻━━━━━━━━━━━┻━━━━━━━━━━━┻━━━━━━━━━━━┻━━━━━━━━━━━┛   ╭───────╮
// │ LEFT  │ ┏━━━━━━━━━━━┓ ┏━━━━━━━━━━━┳━━━━━━━━━━━┳━━━━━━━━━━━┳━━━━━━━━━━━┓   ┏━━━━━━━━━━━┳━━━━━━━━━━━┳━━━━━━━━━━━┳━━━━━━━━━━━┓ ┏━━━━━━━━━━━┓ │ UP    │
// │ RIGHT │ ┃           ┃ ┃           ┃  OPTION   ┃     L2    ┃           ┃   ┃           ┃           ┃           ┃  CONTROL  ┃ ┃           ┃ │ DOWN  │
// ╰───────╯ ┗━━━━━━━━━━━┛ ┗━━━━━━━━━━━┻━━━━━━━━━━━┻━━━━━━━━━━━┻━━━━━━━━━━━┛   ┗━━━━━━━━━━━┻━━━━━━━━━━━┻━━━━━━━━━━━┻━━━━━━━━━━━┛ ┗━━━━━━━━━━━┛ ╰───────╯
    trs__       &m_oe_oeu   &kp _NUMB   &kp M_UDSC  &kp M_MINS  &kp M_PLUS
    trs__       trs__       &m_ea_eau   trs__       trs__       trs__
                trs__       &m_ug_uc    &m_cc_ccu  &m_ag_agu_ac trs__
                no___       trs__       &kp M_OPN   trs__       trs__
                                                                                &kp M_EQAL  trs__       trs__       trs__       &m_eu_li    trs__
                                                                                trs__       trs__       trs__       trs__       &kp M_DOLR  trs__
                                                                                &kp _DOT    trs__       trs__       trs__       trs__
                                                                                trs__       trs__       trs__       &kp M_CTL   no___
// ┃           ┃           ┃           ┃           ┃           ┃           ┃   ┃           ┃           ┃           ┃           ┃           ┃           ┃
, &inc_dec_kp LEFT RIGHT                                                        &inc_dec_kp UP DOWN)

// ┏━━━━━━━━━━━━━━━━━━━━━━━━━━━━━━━━━━━━━━━━━━━━━━━━━━━━━━━━━━━━━━━━━━━━━━━━━━━━━━━━━━━━━━━━━━━━━━━━━━━━━━━━━━━━━━━━━━━━━━━━━━━━━━━━━━━━━━━━━━━━━━━━━━━┓
// ┃                                                                     Tertiary                                                                      ┃
// ┗━━━━━━━━━━━━━━━━━━━━━━━━━━━━━━━━━━━━━━━━━━━━━━━━━━━━━━━━━━━━━━━━━━━━━━━━━━━━━━━━━━━━━━━━━━━━━━━━━━━━━━━━━━━━━━━━━━━━━━━━━━━━━━━━━━━━━━━━━━━━━━━━━━━┛

// Shift mod to release default shift morph    |  Default  |   Shift    |
// ------------------------------------------- | --------- | ---------- |
MORPH(grv, LSFT, &kp _GRV, &kp _GRV)        // | `         | `          |
MORPH(cir, LSFT, &kp _CIR, &kp _CIR)        // | ^         | ^          |
MORPH(tre, LSFT, &kp _TRE, &kp _TRE)        // | ¨         | ¨          |
MORPH(tld, LSFT, &kp _TLD, &kp _TLD)        // | ~         | ~          |

LAYER(TERTIARY,
// ┏━━━━━━━━━━━┳━━━━━━━━━━━┳━━━━━━━━━━━┳━━━━━━━━━━━┳━━━━━━━━━━━┳━━━━━━━━━━━┓   ┏━━━━━━━━━━━┳━━━━━━━━━━━┳━━━━━━━━━━━┳━━━━━━━━━━━┳━━━━━━━━━━━┳━━━━━━━━━━━┓
// ┃    F1     ┃    F2     ┃    F3     ┃    F4     ┃    F5     ┃    F6     ┃   ┃    F7     ┃    F8     ┃    F9     ┃    F10    ┃    F11    ┃    F12    ┃
// ┣━━━━━━━━━━━╋━━━━━━━━━━━╋━━━━━━━━━━━╋━━━━━━━━━━━╋━━━━━━━━━━━╋━━━━━━━━━━━┫   ┣━━━━━━━━━━━╋━━━━━━━━━━━╋━━━━━━━━━━━╋━━━━━━━━━━━╋━━━━━━━━━━━╋━━━━━━━━━━━┫
// ┃   Reset   ┃           ┃     ←     ┃     ↑     ┃     →     ┃           ┃   ┃           ┃     `     ┃     ^     ┃     ¨     ┃     ~     ┃ ALT + F4  ┃
// ┗━━━━━━━━━━━╋━━━━━━━━━━━╋━━━━━━━━━━━╋━━━━━━━━━━━╋━━━━━━━━━━━╋━━━━━━━━━━━┫   ┣━━━━━━━━━━━╋━━━━━━━━━━━╋━━━━━━━━━━━╋━━━━━━━━━━━╋━━━━━━━━━━━╋━━━━━━━━━━━┛
//             ┃           ┃           ┃     ↓     ┃           ┃Print Scree┃   ┃           ┃           ┃           ┃           ┃           ┃
// ╭───────╮   ┗━━━━━━━━━━━┻━━━━━━━━━━━┻━━━━━━━━━━━┻━━━━━━━━━━━┻━━━━━━━━━━━┛   ┗━━━━━━━━━━━┻━━━━━━━━━━━┻━━━━━━━━━━━┻━━━━━━━━━━━┻━━━━━━━━━━━┛   ╭───────╮
// │ UP    │ ┏━━━━━━━━━━━┓ ┏━━━━━━━━━━━┳━━━━━━━━━━━┳━━━━━━━━━━━┳━━━━━━━━━━━┓   ┏━━━━━━━━━━━┳━━━━━━━━━━━┳━━━━━━━━━━━┳━━━━━━━━━━━┓ ┏━━━━━━━━━━━┓ │ LEFT  │
// │ DOWN  │ ┃ Bootloader┃ ┃   CTRL    ┃    ALT    ┃     L3    ┃           ┃   ┃           ┃     L3    ┃           ┃   To L9   ┃ ┃Del BT link┃ │ RIGHT │
// ╰───────╯ ┗━━━━━━━━━━━┛ ┗━━━━━━━━━━━┻━━━━━━━━━━━┻━━━━━━━━━━━┻━━━━━━━━━━━┛   ┗━━━━━━━━━━━┻━━━━━━━━━━━┻━━━━━━━━━━━┻━━━━━━━━━━━┛ ┗━━━━━━━━━━━┛ ╰───────╯
    &kp F1      &kp F2      &kp F3      &kp F4      &kp F5      &kp F6
    &sys_reset  no___       &arw_lft    &arw_up     &arw_rgt    no___
                no___       no___       &arw_dwn    no___       &kp PSCRN
                &bootloader &kp LCTRL   &kp LALT    trs__       no___
                                                                                &kp F7      &kp F8      &kp F9      &kp F10     &kp F11     &kp F12
                                                                                no___       &kp _GRV    &kp _CIR    &kp _TRE    &kp _TLD    &kp LA(F4)
                                                                                &mkp LCLK   &mkp RCLK   no___       no___       no___
                                                                                no___       trs__       no___       &to 13       &bt BT_CLR_ALL
// ┃           ┃           ┃           ┃           ┃           ┃           ┃   ┃           ┃           ┃           ┃           ┃           ┃           ┃
, &inc_dec_kp UP DOWN                                                           &inc_dec_kp LEFT RIGHT)

LAYER(TERTIARY_LINUX,
// ┏━━━━━━━━━━━┳━━━━━━━━━━━┳━━━━━━━━━━━┳━━━━━━━━━━━┳━━━━━━━━━━━┳━━━━━━━━━━━┓   ┏━━━━━━━━━━━┳━━━━━━━━━━━┳━━━━━━━━━━━┳━━━━━━━━━━━┳━━━━━━━━━━━┳━━━━━━━━━━━┓
// ┃           ┃           ┃           ┃           ┃           ┃           ┃   ┃           ┃           ┃           ┃           ┃           ┃           ┃
// ┣━━━━━━━━━━━╋━━━━━━━━━━━╋━━━━━━━━━━━╋━━━━━━━━━━━╋━━━━━━━━━━━╋━━━━━━━━━━━┫   ┣━━━━━━━━━━━╋━━━━━━━━━━━╋━━━━━━━━━━━╋━━━━━━━━━━━╋━━━━━━━━━━━╋━━━━━━━━━━━┫
// ┃           ┃           ┃           ┃           ┃           ┃           ┃   ┃           ┃           ┃           ┃           ┃           ┃           ┃
// ┗━━━━━━━━━━━╋━━━━━━━━━━━╋━━━━━━━━━━━╋━━━━━━━━━━━╋━━━━━━━━━━━╋━━━━━━━━━━━┫   ┣━━━━━━━━━━━╋━━━━━━━━━━━╋━━━━━━━━━━━╋━━━━━━━━━━━╋━━━━━━━━━━━╋━━━━━━━━━━━┛
//             ┃           ┃           ┃           ┃           ┃           ┃   ┃           ┃           ┃           ┃           ┃           ┃
// ╭───────╮   ┗━━━━━━━━━━━┻━━━━━━━━━━━┻━━━━━━━━━━┻━━━━━━━━━━━┻━━━━━━━━━━━┛   ┗━━━━━━━━━━━┻━━━━━━━━━━━┻━━━━━━━━━━━┻━━━━━━━━━━━┻━━━━━━━━━━━┛   ╭───────╮
// │ UP    │ ┏━━━━━━━━━━━┓ ┏━━━━━━━━━━━┳━━━━━━━━━━━┳━━━━━━━━━━━┳━━━━━━━━━━━┓   ┏━━━━━━━━━━━┳━━━━━━━━━━━┳━━━━━━━━━━━┳━━━━━━━━━━━┓ ┏━━━━━━━━━━━┓ │ LEFT  │
// │ DOWN  │ ┃           ┃ ┃           ┃           ┃           ┃           ┃   ┃           ┃           ┃           ┃           ┃ ┃           ┃ │ RIGHT │
// ╰───────╯ ┗━━━━━━━━━━━┛ ┗━━━━━━━━━━━┻━━━━━━━━━━━┻━━━━━━━━━━━┻━━━━━━━━━━━┛   ┗━━━━━━━━━━━┻━━━━━━━━━━━┻━━━━━━━━━━━┻━━━━━━━━━━━┛ ┗━━━━━━━━━━━┛ ╰───────╯
    trs__       trs__       trs__       trs__       trs__       trs__
    trs__       trs__       trs__       trs__       trs__       trs__
                trs__       trs__       trs__       trs__       trs__
                trs__       trs__       trs__       trs__       trs__
                                                                                trs__       trs__       trs__       trs__       trs__       trs__
                                                                                trs__       trs__       trs__       trs__       trs__       trs__
                                                                                trs__       trs__       trs__       trs__       trs__
                                                                                trs__       trs__       trs__       trs__       &bt BT_CLR_ALL
// ┃           ┃           ┃           ┃           ┃           ┃           ┃   ┃           ┃           ┃           ┃           ┃           ┃           ┃
, &inc_dec_kp UP DOWN                                                           &inc_dec_kp LEFT RIGHT)

// Shift mod to release default shift morph    |  Default    |   Shift    |
// ------------------------------------------- | ----------- | ---------- |
MORPH(MF_U, LSFT, &kp F_U, &kp M_U)         // | Focus Up    | Move Up    |
MORPH(MF_D, LSFT, &kp F_D, &kp M_D)         // | Focus Down  | Move Down  |
MORPH(MF_L, LSFT, &kp F_L, &kp M_L)         // | Focus Left  | Move Left  |
MORPH(MF_R, LSFT, &kp F_R, &kp M_R)         // | Focus Right | Move Right |
MORPH(MF_1, LSFT, &kp F_1, &kp M_1)         // | Focus 1     | Move 1     |
MORPH(MF_2, LSFT, &kp F_2, &kp M_2)         // | Focus 2     | Move 2     |
MORPH(MF_3, LSFT, &kp F_3, &kp M_3)         // | Focus 3     | Move 3     |

LAYER(TERTIARY_MACOS,
// ┏━━━━━━━━━━━┳━━━━━━━━━━━┳━━━━━━━━━━━┳━━━━━━━━━━━┳━━━━━━━━━━━┳━━━━━━━━━━━┓   ┏━━━━━━━━━━━┳━━━━━━━━━━━┳━━━━━━━━━━━┳━━━━━━━━━━━┳━━━━━━━━━━━┳━━━━━━━━━━━┓
// ┃           ┃           ┃   Tiles   ┃ Floating  ┃ Accordion ┃           ┃   ┃           ┃   Aero 1  ┃   Aero 2  ┃   Aero 3  ┃           ┃           ┃
// ┣━━━━━━━━━━━╋━━━━━━━━━━━╋━━━━━━━━━━━╋━━━━━━━━━━━╋━━━━━━━━━━━╋━━━━━━━━━━━┫   ┣━━━━━━━━━━━╋━━━━━━━━━━━╋━━━━━━━━━━━╋━━━━━━━━━━━╋━━━━━━━━━━━╋━━━━━━━━━━━┫
// ┃           ┃           ┃ M/F to L  ┃ M/F to U  ┃ M/F to R  ┃           ┃   ┃     ´     ┃     `     ┃     ^     ┃     ¨     ┃     ~     ┃           ┃
// ┗━━━━━━━━━━━╋━━━━━━━━━━━╋━━━━━━━━━━━╋━━━━━━━━━━━╋━━━━━━━━━━━╋━━━━━━━━━━━┫   ┣━━━━━━━━━━━╋━━━━━━━━━━━╋━━━━━━━━━━━╋━━━━━━━━━━━╋━━━━━━━━━━━╋━━━━━━━━━━━┛
//             ┃           ┃           ┃ M/F to D  ┃           ┃Print Scree┃   ┃           ┃           ┃           ┃           ┃           ┃
// ╭───────╮   ┗━━━━━━━━━━━┻━━━━━━━━━━━┻━━━━━━━━━━━┻━━━━━━━━━━━┻━━━━━━━━━━━┛   ┗━━━━━━━━━━━┻━━━━━━━━━━━┻━━━━━━━━━━━┻━━━━━━━━━━━┻━━━━━━━━━━━┛   ╭───────╮
// │ UP    │ ┏━━━━━━━━━━━┓ ┏━━━━━━━━━━━┳━━━━━━━━━━━┳━━━━━━━━━━━┳━━━━━━━━━━━┓   ┏━━━━━━━━━━━┳━━━━━━━━━━━┳━━━━━━━━━━━┳━━━━━━━━━━━┓ ┏━━━━━━━━━━━┓ │ LEFT  │
// │ DOWN  │ ┃           ┃ ┃           ┃           ┃           ┃           ┃   ┃   LSHIFT  ┃           ┃           ┃           ┃ ┃           ┃ │ RIGHT │
// ╰───────╯ ┗━━━━━━━━━━━┛ ┗━━━━━━━━━━━┻━━━━━━━━━━━┻━━━━━━━━━━━┻━━━━━━━━━━━┛   ┗━━━━━━━━━━━┻━━━━━━━━━━━┻━━━━━━━━━━━┻━━━━━━━━━━━┛ ┗━━━━━━━━━━━┛ ╰───────╯
    trs__       trs__       &kp F_T     &kp F_F     &kp F_A     trs__
    trs__       no___       &MF_L       &MF_U       &MF_R       no___
                no___       no___       &MF_D       no___       &kp LS(RA(_Q))
                trs__       no___       no___       trs__       no___
                                                                                trs__       &MF_1       &MF_2       &MF_3       trs__       trs__
                                                                                &kp M_AGU   &kp M_GRV   &kp M_CIR   &kp M_TRE   &kp M_TLD   no___
                                                                                no___       no___       no___       no___       no___
                                                                                &kp LSHIFT  trs__       no___       no___       &bt BT_CLR_ALL
// ┃           ┃           ┃           ┃           ┃           ┃           ┃   ┃           ┃           ┃           ┃           ┃           ┃           ┃
, &inc_dec_kp UP DOWN                                                           &inc_dec_kp LEFT RIGHT)

// ┏━━━━━━━━━━━━━━━━━━━━━━━━━━━━━━━━━━━━━━━━━━━━━━━━━━━━━━━━━━━━━━━━━━━━━━━━━━━━━━━━━━━━━━━━━━━━━━━━━━━━━━━━━━━━━━━━━━━━━━━━━━━━━━━━━━━━━━━━━━━━━━━━━━━┓
// ┃                                                                      Numpad                                                                       ┃
// ┗━━━━━━━━━━━━━━━━━━━━━━━━━━━━━━━━━━━━━━━━━━━━━━━━━━━━━━━━━━━━━━━━━━━━━━━━━━━━━━━━━━━━━━━━━━━━━━━━━━━━━━━━━━━━━━━━━━━━━━━━━━━━━━━━━━━━━━━━━━━━━━━━━━━┛

// Macros
MACRO_WRITE(numpad, &kp LS(_N) &kp _U &kp _M &kp _P &kp _A &kp _D, &kp BSPC &kp BSPC &kp BSPC &kp BSPC &kp BSPC &kp BSPC)

/* "Numpad lock and Fusion 360" shortcuts

Common use case:
- `NUMPAD` allways on to enter values

Left hand on keyboard, and right hand on mouse (for Fusion 360):
- `BSPACE` and `DEL` to delete elements selected with the mouse
- `CTRL` + `X` / `C` / `V` to cut / copuy / paste elements
- `CTRL` + `Z` / `Y` to undo / redo last action
- `CTRL` + `A` to select all elements
- `ARROW` to move the selected element
*/

LAYER(NUMPAD,
// ┏━━━━━━━━━━━┳━━━━━━━━━━━┳━━━━━━━━━━━┳━━━━━━━━━━━┳━━━━━━━━━━━┳━━━━━━━━━━━┓   ┏━━━━━━━━━━━┳━━━━━━━━━━━┳━━━━━━━━━━━┳━━━━━━━━━━━┳━━━━━━━━━━━┳━━━━━━━━━━━┓
// ┃    ESC    ┃     A     ┃     Z     ┃     ↑     ┃     -     ┃     +     ┃   ┃     =     ┃     7     ┃     8     ┃     9     ┃   € + £   ┃   BSPACE  ┃
// ┣━━━━━━━━━━━╋━━━━━━━━━━━╋━━━━━━━━━━━╋━━━━━━━━━━━╋━━━━━━━━━━━╋━━━━━━━━━━━┫   ┣━━━━━━━━━━━╋━━━━━━━━━━━╋━━━━━━━━━━━╋━━━━━━━━━━━╋━━━━━━━━━━━╋━━━━━━━━━━━┫
// ┃    TAB    ┃     Y     ┃     ←     ┃     ↓     ┃     →     ┃     *     ┃   ┃     0     ┃     4     ┃     5     ┃     6     ┃     $     ┃    DEL    ┃
// ┗━━━━━━━━━━━╋━━━━━━━━━━━╋━━━━━━━━━━━╋━━━━━━━━━━━╋━━━━━━━━━━━╋━━━━━━━━━━━┫   ┣━━━━━━━━━━━╋━━━━━━━━━━━╋━━━━━━━━━━━╋━━━━━━━━━━━╋━━━━━━━━━━━╋━━━━━━━━━━━┛
//             ┃           ┃     X     ┃     C     ┃     V     ┃     /     ┃   ┃     .     ┃     1     ┃     2     ┃     3     ┃     %     ┃
// ╭───────╮   ┗━━━━━━━━━━━┻━━━━━━━━━━━┻━━━━━━━━━━━┻━━━━━━━━━━━┻━━━━━━━━━━━┛   ┗━━━━━━━━━━━┻━━━━━━━━━━━┻━━━━━━━━━━━┻━━━━━━━━━━━┻━━━━━━━━━━━┛   ╭───────╮
// │ LEFT  │ ┏━━━━━━━━━━━┓ ┏━━━━━━━━━━━┳━━━━━━━━━━━┳━━━━━━━━━━━┳━━━━━━━━━━━┓   ┏━━━━━━━━━━━┳━━━━━━━━━━━┳━━━━━━━━━━━┳━━━━━━━━━━━┓ ┏━━━━━━━━━━━┓ │ UP    │
// │ RIGHT │ ┃           ┃ ┃   CTRL    ┃           ┃   BSPACE  ┃    DEL    ┃   ┃   SPACE   ┃           ┃   ENTER   ┃    WIN    ┃ ┃  "numpad" ┃ │ DOWN  │
// ╰───────╯ ┗━━━━━━━━━━━┛ ┗━━━━━━━━━━━┻━━━━━━━━━━━┻━━━━━━━━━━━┻━━━━━━━━━━━┛   ┗━━━━━━━━━━━┻━━━━━━━━━━━┻━━━━━━━━━━━┻━━━━━━━━━━━┛ ┗━━━━━━━━━━━┛ ╰───────╯
    trs__       &kp _A      &kp _Z      &kp UP      &mins       &plus
    trs__       &kp _Y      &kp LEFT    &kp DOWN    &kp RIGHT   &astr
                no___       &kp _X      &kp _C      &kp _V      &divi
                no___       &kp LCTRL   no___       &kp BSPC    &kp DEL
                                                                                &eqal       &n_7        &n_8        &n_9        &eu_li      trs__
                                                                                &n_0        &n_4        &n_5        &n_6        &dolr       trs__
                                                                                &n_dt       &n_1        &n_2        &n_3        &perc
                                                                                &kp SPACE   &to 0       &kp ENTER   &kp LGUI    &numpad
// ┃           ┃           ┃           ┃           ┃           ┃           ┃   ┃           ┃           ┃           ┃           ┃           ┃           ┃
, &inc_dec_kp LEFT RIGHT                                                        &inc_dec_kp UP DOWN)


// ┏━━━━━━━━━━━━━━━━━━━━━━━━━━━━━━━━━━━━━━━━━━━━━━━━━━━━━━━━━━━━━━━━━━━━━━━━━━━━━━━━━━━━━━━━━━━━━━━━━━━━━━━━━━━━━━━━━━━━━━━━━━━━━━━━━━━━━━━━━━━━━━━━━━━┓
// ┃                                                                      Gaming                                                                       ┃
// ┗━━━━━━━━━━━━━━━━━━━━━━━━━━━━━━━━━━━━━━━━━━━━━━━━━━━━━━━━━━━━━━━━━━━━━━━━━━━━━━━━━━━━━━━━━━━━━━━━━━━━━━━━━━━━━━━━━━━━━━━━━━━━━━━━━━━━━━━━━━━━━━━━━━━┛

// Macros
MACRO_WRITE(gaming, &kp LS(_G) &kp _A &kp _M &kp _I &kp _N &kp _G, &kp BSPC &kp BSPC &kp BSPC &kp BSPC &kp BSPC &kp BSPC)

LAYER(GAMING,
// ┏━━━━━━━━━━━┳━━━━━━━━━━━┳━━━━━━━━━━━┳━━━━━━━━━━━┳━━━━━━━━━━━┳━━━━━━━━━━━┓   ┏━━━━━━━━━━━┳━━━━━━━━━━━┳━━━━━━━━━━━┳━━━━━━━━━━━┳━━━━━━━━━━━┳━━━━━━━━━━━┓
// ┃ (TAB)→ESC ┃     A     ┃     Z     ┃     E     ┃     R     ┃     T     ┃   ┃     Y     ┃     U     ┃     I     ┃     O     ┃     P     ┃   BSPACE  ┃
// ┣━━━━━━━━━━━╋━━━━━━━━━━━╋━━━━━━━━━━━╋━━━━━━━━━━━╋━━━━━━━━━━━╋━━━━━━━━━━━┫   ┣━━━━━━━━━━━╋━━━━━━━━━━━╋━━━━━━━━━━━╋━━━━━━━━━━━╋━━━━━━━━━━━╋━━━━━━━━━━━┫
// ┃    TAB    ┃     Q     ┃     S     ┃     D     ┃     F     ┃     G     ┃   ┃     H     ┃     J     ┃     K     ┃     L     ┃     M     ┃    DEL    ┃
// ┗━━━━━━━━━━━╋━━━━━━━━━━━╋━━━━━━━━━━━╋━━━━━━━━━━━╋━━━━━━━━━━━╋━━━━━━━━━━━┫   ┣━━━━━━━━━━━╋━━━━━━━━━━━╋━━━━━━━━━━━╋━━━━━━━━━━━╋━━━━━━━━━━━╋━━━━━━━━━━━┛
//             ┃     W     ┃     X     ┃     C     ┃     V     ┃     B     ┃   ┃     N     ┃  , or ?   ┃  . or !   ┃  ; or /   ┃  : or \   ┃
// ╭───────╮   ┗━━━━━━━━━━━┻━━━━━━━━━━━┻━━━━━━━━━━━┻━━━━━━━━━━━┻━━━━━━━━━━━┛   ┗━━━━━━━━━━━┻━━━━━━━━━━━┻━━━━━━━━━━━┻━━━━━━━━━━━┻━━━━━━━━━━━┛   ╭───────╮
// │ VOL+  │ ┏━━━━━━━━━━━┓ ┏━━━━━━━━━━━┳━━━━━━━━━━━┳━━━━━━━━━━━┳━━━━━━━━━━━┓   ┏━━━━━━━━━━━┳━━━━━━━━━━━┳━━━━━━━━━━━┳━━━━━━━━━━━┓ ┏━━━━━━━━━━━┓ │ VOL+  │
// │ VOL-  │ ┃           ┃ ┃     +     ┃     -     ┃     '     ┃   SPACE   ┃   ┃   SHIFT   ┃    L14    ┃   ENTER   ┃    WIN    ┃ ┃ "Gaming"  ┃ │ VOL-  │
// ╰───────╯ ┗━━━━━━━━━━━┛ ┗━━━━━━━━━━━┻━━━━━━━━━━━┻━━━━━━━━━━━┻━━━━━━━━━━━┛   ┗━━━━━━━━━━━┻━━━━━━━━━━━┻━━━━━━━━━━━┻━━━━━━━━━━━┛ ┗━━━━━━━━━━━┛ ╰───────╯
    &mt ESC TAB &kp _A     &kp _Z      &kp _E      &kp _R      &kp _T 
    &kp TAB     &kp _Q     &kp _S      &kp _D      &kp _F      &kp _G
                &kp _W     &kp _X      &kp _C      &kp _V      &kp _B
                no___      &kp _PLUS   &kp _MINS   &kp _SQUO   &kp SPACE
                                                                                &kp _Y      &kp _U      &kp _I      &kp _O      &kp _P      &kp BSPC
                                                                                &kp _H      &kp _J      &kp _K      &kp _L      &kp _M      &kp DEL
                                                                                &kp _N      &comm_qmark &dot_excl   &semi_slsh  &colon_bsls
                                                                                &kp LSHIFT  &mo 14      &kp ENTER   &kp LGUI    &gaming
// ┃           ┃           ┃           ┃           ┃           ┃           ┃   ┃           ┃           ┃           ┃           ┃           ┃           ┃
, &inc_dec_kp C_VOL_DN C_VOL_UP                                                 &inc_dec_kp C_VOL_DN C_VOL_UP)

LAYER(GAMING_2,
// ┏━━━━━━━━━━━┳━━━━━━━━━━━┳━━━━━━━━━━━┳━━━━━━━━━━━┳━━━━━━━━━━━┳━━━━━━━━━━━┓   ┏━━━━━━━━━━━┳━━━━━━━━━━━┳━━━━━━━━━━━┳━━━━━━━━━━━┳━━━━━━━━━━━┳━━━━━━━━━━━┓
// ┃           ┃           ┃           ┃           ┃           ┃           ┃   ┃     "     ┃NV ScrenSht┃           ┃           ┃           ┃           ┃
// ┣━━━━━━━━━━━╋━━━━━━━━━━━╋━━━━━━━━━━━╋━━━━━━━━━━━╋━━━━━━━━━━━╋━━━━━━━━━━━┫   ┣━━━━━━━━━━━╋━━━━━━━━━━━╋━━━━━━━━━━━╋━━━━━━━━━━━╋━━━━━━━━━━━╋━━━━━━━━━━━┫
// ┃           ┃           ┃           ┃           ┃           ┃           ┃   ┃     '     ┃NV Save Rec┃NV StartRec┃           ┃           ┃           ┃
// ┗━━━━━━━━━━━╋━━━━━━━━━━━╋━━━━━━━━━━━╋━━━━━━━━━━━╋━━━━━━━━━━━╋━━━━━━━━━━━┫   ┣━━━━━━━━━━━╋━━━━━━━━━━━╋━━━━━━━━━━━╋━━━━━━━━━━━╋━━━━━━━━━━━╋━━━━━━━━━━━┛
//             ┃           ┃           ┃           ┃           ┃           ┃   ┃     `     ┃NV Dashbrd ┃  NV FPS   ┃ NV Rotate ┃           ┃
// ╭───────╮   ┗━━━━━━━━━━━┻━━━━━━━━━━━┻━━━━━━━━━━━┻━━━━━━━━━━━┻━━━━━━━━━━━┛   ┗━━━━━━━━━━━┻━━━━━━━━━━━┻━━━━━━━━━━━┻━━━━━━━━━━━┻━━━━━━━━━━━┛   ╭───────╮
// │ VOL+  │ ┏━━━━━━━━━━━┓ ┏━━━━━━━━━━━┳━━━━━━━━━━━┳━━━━━━━━━━━┳━━━━━━━━━━━┓   ┏━━━━━━━━━━━┳━━━━━━━━━━━┳━━━━━━━━━━━┳━━━━━━━━━━━┓ ┏━━━━━━━━━━━┓ │ VOL+  │
// │ VOL-  │ ┃           ┃ ┃   CTRL    ┃    ALT    ┃           ┃           ┃   ┃           ┃    L14    ┃           ┃           ┃ ┃ To Windows┃ │ VOL-  │
// ╰───────╯ ┗━━━━━━━━━━━┛ ┗━━━━━━━━━━━┻━━━━━━━━━━━┻━━━━━━━━━━━┻━━━━━━━━━━━┛   ┗━━━━━━━━━━━┻━━━━━━━━━━━┻━━━━━━━━━━━┻━━━━━━━━━━━┛ ┗━━━━━━━━━━━┛ ╰───────╯
    no___       no___       no___       no___       no___       no___
    trs__       no___       no___       no___       no___       no___
                no___       no___       no___       no___       no___
                no___       &kp LCTRL   &kp LALT    no___       trs__
                                                                                &quot       &kp LC(F1)  &kp LC(F2)  &kp LC(F3)  &kp LC(F4)  trs__
                                                                                &squo       &kp LC(F5)  &kp LC(F6)  &kp LC(F7)  &kp LC(F8)  trs__
                                                                                &fr_grv     &kp LC(F9)  &kp LC(F10) &kp LC(F11) &kp LC(F12)
                                                                                trs__       trs__       trs__       trs__       &to 0
// ┃           ┃           ┃           ┃           ┃           ┃           ┃   ┃           ┃           ┃           ┃           ┃           ┃           ┃
, &inc_dec_kp C_VOL_DN C_VOL_UP                                                 &inc_dec_kp C_VOL_DN C_VOL_UP)