// HOST_NEXT vaut ∅ hors bluetooth auto, sinon il sélectionne l’hôte connecté suivant.
#ifndef HOST_NEXT
#define HOST_NEXT no___
#define HOST_NEXT_LOCAL
#endif

// Keymap macOS fixe : la couche zéro reste le même OS après redémarrage.

// · : action héritée d’une couche inférieure. ∅ : aucune action.
// Dans é/É ou à/â/À, les actions suivent le nombre d’appuis. → : appui bref puis maintien.
// L1 : primaire, double appui secondaire, triple appui pavé. L2 : secondaire, double primaire.
// Les encadrés extérieurs indiquent les deux actions de rotation, dans l’ordre des bindings.
// AS : raccourcis AeroSpace. Foc/Dépl : focus, déplacement avec Shift. ⇧ : Shift, ⌥ : Option.

// Base et encodeurs.
// Paramètres OS de la base commune.
#define BASE_LAYER(bindings, sensors) LAYER(BASE, bindings, sensors)
#define BASE_CTRL &kp M_CMD
#define BASE_ALT &kp M_OPN
#define BASE_DOT &m_dot_excl
#define BASE_BSLS &m_colon_bsls
#define BASE_GUI &kp M_CTL
#define BASE_OS &mac

// ┏━━━━━━━━━━━┳━━━━━━━━━━━┳━━━━━━━━━━━┳━━━━━━━━━━━┳━━━━━━━━━━━┳━━━━━━━━━━━┓   ┏━━━━━━━━━━━┳━━━━━━━━━━━┳━━━━━━━━━━━┳━━━━━━━━━━━┳━━━━━━━━━━━┳━━━━━━━━━━━┓
// ┃    ESC    ┃     A     ┃     Z     ┃     E     ┃     R     ┃     T     ┃   ┃     Y     ┃     U     ┃     I     ┃     O     ┃     P     ┃   BSPACE  ┃
// ┣━━━━━━━━━━━╋━━━━━━━━━━━╋━━━━━━━━━━━╋━━━━━━━━━━━╋━━━━━━━━━━━╋━━━━━━━━━━━┫   ┣━━━━━━━━━━━╋━━━━━━━━━━━╋━━━━━━━━━━━╋━━━━━━━━━━━╋━━━━━━━━━━━╋━━━━━━━━━━━┫
// ┃    TAB    ┃     Q     ┃     S     ┃     D     ┃     F     ┃     G     ┃   ┃     H     ┃     J     ┃     K     ┃     L     ┃     M     ┃    DEL    ┃
// ┗━━━━━━━━━━━╋━━━━━━━━━━━╋━━━━━━━━━━━╋━━━━━━━━━━━╋━━━━━━━━━━━╋━━━━━━━━━━━┫   ┣━━━━━━━━━━━╋━━━━━━━━━━━╋━━━━━━━━━━━╋━━━━━━━━━━━╋━━━━━━━━━━━╋━━━━━━━━━━━┛
//             ┃     W     ┃     X     ┃     C     ┃     V     ┃     B     ┃   ┃     N     ┃   , ou ?  ┃   . ou !  ┃   ; ou /  ┃   : ou \  ┃
// ╭───────╮   ┗━━━━━━━━━━━┻━━━━━━━━━━━┻━━━━━━━━━━━┻━━━━━━━━━━━┻━━━━━━━━━━━┛   ┗━━━━━━━━━━━┻━━━━━━━━━━━┻━━━━━━━━━━━┻━━━━━━━━━━━┻━━━━━━━━━━━┛   ╭───────╮
// │  VOL- │ ┏━━━━━━━━━━━┓ ┏━━━━━━━━━━━┳━━━━━━━━━━━┳━━━━━━━━━━━┳━━━━━━━━━━━┓   ┏━━━━━━━━━━━┳━━━━━━━━━━━┳━━━━━━━━━━━┳━━━━━━━━━━━┓ ┏━━━━━━━━━━━┓ │  LEFT │
// │  VOL+ │ ┃ Play→Mute ┃ ┃  COMMAND  ┃   OPTION  ┃     L2    ┃   SPACE   ┃   ┃ SHIFT+LOCK┃     L1    ┃   ENTER   ┃    CTRL   ┃ ┃   macOS   ┃ │ RIGHT │
// ╰───────╯ ┗━━━━━━━━━━━┛ ┗━━━━━━━━━━━┻━━━━━━━━━━━┻━━━━━━━━━━━┻━━━━━━━━━━━┛   ┗━━━━━━━━━━━┻━━━━━━━━━━━┻━━━━━━━━━━━┻━━━━━━━━━━━┛ ┗━━━━━━━━━━━┛ ╰───────╯
#include "../common/base-layer.dtsi"

// Navigation et symboles.
LAYER(PRIMARY,
// ┏━━━━━━━━━━━┳━━━━━━━━━━━┳━━━━━━━━━━━┳━━━━━━━━━━━┳━━━━━━━━━━━┳━━━━━━━━━━━┓   ┏━━━━━━━━━━━┳━━━━━━━━━━━┳━━━━━━━━━━━┳━━━━━━━━━━━┳━━━━━━━━━━━┳━━━━━━━━━━━┓
// ┃     ∅     ┃     ∅     ┃Début ligne┃     ∅     ┃ Fin ligne ┃     ∅     ┃   ┃     "     ┃     (     ┃     )     ┃     [     ┃     ]     ┃     ·     ┃
// ┣━━━━━━━━━━━╋━━━━━━━━━━━╋━━━━━━━━━━━╋━━━━━━━━━━━╋━━━━━━━━━━━╋━━━━━━━━━━━┫   ┣━━━━━━━━━━━╋━━━━━━━━━━━╋━━━━━━━━━━━╋━━━━━━━━━━━╋━━━━━━━━━━━╋━━━━━━━━━━━┫
// ┃     ∅     ┃     ∅     ┃     ←     ┃     ↑     ┃     →     ┃     ->    ┃   ┃     '     ┃     {     ┃     }     ┃     <     ┃     >     ┃     ·     ┃
// ┗━━━━━━━━━━━╋━━━━━━━━━━━╋━━━━━━━━━━━╋━━━━━━━━━━━╋━━━━━━━━━━━╋━━━━━━━━━━━┫   ┣━━━━━━━━━━━╋━━━━━━━━━━━╋━━━━━━━━━━━╋━━━━━━━━━━━╋━━━━━━━━━━━╋━━━━━━━━━━━┛
//             ┃     ∅     ┃   Mot ←   ┃     ↓     ┃   Mot →   ┃     =>    ┃   ┃     `     ┃     #     ┃     &     ┃     |     ┃     @     ┃
// ╭───────╮   ┗━━━━━━━━━━━┻━━━━━━━━━━━┻━━━━━━━━━━━┻━━━━━━━━━━━┻━━━━━━━━━━━┛   ┗━━━━━━━━━━━┻━━━━━━━━━━━┻━━━━━━━━━━━┻━━━━━━━━━━━┻━━━━━━━━━━━┛   ╭───────╮
// │  LEFT │ ┏━━━━━━━━━━━┓ ┏━━━━━━━━━━━┳━━━━━━━━━━━┳━━━━━━━━━━━┳━━━━━━━━━━━┓   ┏━━━━━━━━━━━┳━━━━━━━━━━━┳━━━━━━━━━━━┳━━━━━━━━━━━┓ ┏━━━━━━━━━━━┓ │   UP  │
// │ RIGHT │ ┃     ∅     ┃ ┃  COMMAND  ┃   OPTION  ┃     ·     ┃   SHIFT   ┃   ┃   SHIFT   ┃     ·     ┃     ·     ┃    CTRL   ┃ ┃ HOST_NEXT ┃ │  DOWN │
// ╰───────╯ ┗━━━━━━━━━━━┛ ┗━━━━━━━━━━━┻━━━━━━━━━━━┻━━━━━━━━━━━┻━━━━━━━━━━━┛   ┗━━━━━━━━━━━┻━━━━━━━━━━━┻━━━━━━━━━━━┻━━━━━━━━━━━┛ ┗━━━━━━━━━━━┛ ╰───────╯
    no___       no___       &kp M_HOME  no___       &kp M_END   no___
    no___       no___       &kp LEFT    &kp UP      &kp RIGHT   &m_arw_s
                no___       &kp M_LWRD  &kp DOWN    &kp M_RWRD  &m_arw_d
            no___           &kp M_CMD   &kp M_OPN   trs__       &kp LSHIFT
                                                                                &quot       &lpar       &rpar       &kp M_LCRO  &kp M_RCRO  trs__
                                                                                &squo       &kp M_LACC  &kp M_RACC  &kp M_LCHE  &kp M_RCHE  trs__
                                                                                &m_grv      &kp M_HASH  &and        &kp M_PIPE  &kp M_AT
                                                                                &kp LSHIFT  trs__       trs__       &kp M_CTL   HOST_NEXT
, &inc_dec_kp LEFT RIGHT                                                        &inc_dec_kp UP DOWN)

// Accents et nombres.
LAYER(SECONDARY,
// ┏━━━━━━━━━━━┳━━━━━━━━━━━┳━━━━━━━━━━━┳━━━━━━━━━━━┳━━━━━━━━━━━┳━━━━━━━━━━━┓   ┏━━━━━━━━━━━┳━━━━━━━━━━━┳━━━━━━━━━━━┳━━━━━━━━━━━┳━━━━━━━━━━━┳━━━━━━━━━━━┓
// ┃   BSPACE  ┃    œ/Œ    ┃     °     ┃     _     ┃     -     ┃     +     ┃   ┃     =     ┃     7     ┃     8     ┃     9     ┃    €/£    ┃     ·     ┃
// ┣━━━━━━━━━━━╋━━━━━━━━━━━╋━━━━━━━━━━━╋━━━━━━━━━━━╋━━━━━━━━━━━╋━━━━━━━━━━━┫   ┣━━━━━━━━━━━╋━━━━━━━━━━━╋━━━━━━━━━━━╋━━━━━━━━━━━╋━━━━━━━━━━━╋━━━━━━━━━━━┫
// ┃    DEL    ┃    ô/Ô    ┃    é/É    ┃    ê/Ê    ┃    è/ë    ┃     *     ┃   ┃     0     ┃     4     ┃     5     ┃     6     ┃     $     ┃     ·     ┃
// ┗━━━━━━━━━━━╋━━━━━━━━━━━╋━━━━━━━━━━━╋━━━━━━━━━━━╋━━━━━━━━━━━╋━━━━━━━━━━━┫   ┣━━━━━━━━━━━╋━━━━━━━━━━━╋━━━━━━━━━━━╋━━━━━━━━━━━╋━━━━━━━━━━━╋━━━━━━━━━━━┛
//             ┃    î/ï    ┃   ù/û/µ   ┃    ç/Ç    ┃   à/â/À   ┃     /     ┃   ┃     .     ┃     1     ┃     2     ┃     3     ┃     %     ┃
// ╭───────╮   ┗━━━━━━━━━━━┻━━━━━━━━━━━┻━━━━━━━━━━━┻━━━━━━━━━━━┻━━━━━━━━━━━┛   ┗━━━━━━━━━━━┻━━━━━━━━━━━┻━━━━━━━━━━━┻━━━━━━━━━━━┻━━━━━━━━━━━┛   ╭───────╮
// │  LEFT │ ┏━━━━━━━━━━━┓ ┏━━━━━━━━━━━┳━━━━━━━━━━━┳━━━━━━━━━━━┳━━━━━━━━━━━┓   ┏━━━━━━━━━━━┳━━━━━━━━━━━┳━━━━━━━━━━━┳━━━━━━━━━━━┓ ┏━━━━━━━━━━━┓ │   UP  │
// │ RIGHT │ ┃     ∅     ┃ ┃     ·     ┃   OPTION  ┃     ·     ┃   ENTER   ┃   ┃   SPACE   ┃     ·     ┃     ·     ┃    CTRL   ┃ ┃     ∅     ┃ │  DOWN │
// ╰───────╯ ┗━━━━━━━━━━━┛ ┗━━━━━━━━━━━┻━━━━━━━━━━━┻━━━━━━━━━━━┻━━━━━━━━━━━┛   ┗━━━━━━━━━━━┻━━━━━━━━━━━┻━━━━━━━━━━━┻━━━━━━━━━━━┛ ┗━━━━━━━━━━━┛ ╰───────╯
    &kp BSPC    &m_oe_oeu   &kp _NUMB   &kp M_UDSC  &kp M_MINS  &kp M_PLUS
    &kp DEL     &oc_ocu     &m_ea_eau   &ec_ecu     &eg_et      &astr
                &ic_it      &m_ug_uc    &m_cc_ccu   &m_ag_agu_ac&divi
            no___           trs__       &kp M_OPN   trs__       &kp ENTER
                                                                                &kp M_EQAL  &n_7        &n_8        &n_9        &m_eu_li    trs__
                                                                                &n_0        &n_4        &n_5        &n_6        &kp M_DOLR  trs__
                                                                                &kp _DOT    &n_1        &n_2        &n_3        &perc
                                                                                &kp SPACE   trs__       trs__       &kp M_CTL   no___
, &inc_dec_kp LEFT RIGHT                                                        &inc_dec_kp UP DOWN)

// Fonctions et système.
LAYER(TERTIARY,
// ┏━━━━━━━━━━━┳━━━━━━━━━━━┳━━━━━━━━━━━┳━━━━━━━━━━━┳━━━━━━━━━━━┳━━━━━━━━━━━┓   ┏━━━━━━━━━━━┳━━━━━━━━━━━┳━━━━━━━━━━━┳━━━━━━━━━━━┳━━━━━━━━━━━┳━━━━━━━━━━━┓
// ┃     F1    ┃     F2    ┃ AS tuiles ┃AS flottant┃ AS accord.┃     F6    ┃   ┃     F7    ┃ Foc/Dépl 1┃ Foc/Dépl 2┃ Foc/Dépl 3┃    F11    ┃    F12    ┃
// ┣━━━━━━━━━━━╋━━━━━━━━━━━╋━━━━━━━━━━━╋━━━━━━━━━━━╋━━━━━━━━━━━╋━━━━━━━━━━━┫   ┣━━━━━━━━━━━╋━━━━━━━━━━━╋━━━━━━━━━━━╋━━━━━━━━━━━╋━━━━━━━━━━━╋━━━━━━━━━━━┫
// ┃   Reset   ┃     ∅     ┃ Foc/Dépl ←┃ Foc/Dépl ↑┃ Foc/Dépl →┃     ∅     ┃   ┃   ´ mort  ┃   ` mort  ┃   ^ mort  ┃   ¨ mort  ┃   ~ mort  ┃     ∅     ┃
// ┗━━━━━━━━━━━╋━━━━━━━━━━━╋━━━━━━━━━━━╋━━━━━━━━━━━╋━━━━━━━━━━━╋━━━━━━━━━━━┫   ┣━━━━━━━━━━━╋━━━━━━━━━━━╋━━━━━━━━━━━╋━━━━━━━━━━━╋━━━━━━━━━━━╋━━━━━━━━━━━┛
//             ┃     ∅     ┃     ∅     ┃ Foc/Dépl ↓┃     ∅     ┃    ⇧⌥Q    ┃   ┃     ∅     ┃     ∅     ┃     ∅     ┃     ∅     ┃     ∅     ┃
// ╭───────╮   ┗━━━━━━━━━━━┻━━━━━━━━━━━┻━━━━━━━━━━━┻━━━━━━━━━━━┻━━━━━━━━━━━┛   ┗━━━━━━━━━━━┻━━━━━━━━━━━┻━━━━━━━━━━━┻━━━━━━━━━━━┻━━━━━━━━━━━┛   ╭───────╮
// │   UP  │ ┏━━━━━━━━━━━┓ ┏━━━━━━━━━━━┳━━━━━━━━━━━┳━━━━━━━━━━━┳━━━━━━━━━━━┓   ┏━━━━━━━━━━━┳━━━━━━━━━━━┳━━━━━━━━━━━┳━━━━━━━━━━━┓ ┏━━━━━━━━━━━┓ │  LEFT │
// │  DOWN │ ┃ Bootloader┃ ┃     ∅     ┃     ∅     ┃     ·     ┃     ∅     ┃   ┃   SHIFT   ┃     ·     ┃     ∅     ┃     ∅     ┃ ┃ Efface BLE┃ │ RIGHT │
// ╰───────╯ ┗━━━━━━━━━━━┛ ┗━━━━━━━━━━━┻━━━━━━━━━━━┻━━━━━━━━━━━┻━━━━━━━━━━━┛   ┗━━━━━━━━━━━┻━━━━━━━━━━━┻━━━━━━━━━━━┻━━━━━━━━━━━┛ ┗━━━━━━━━━━━┛ ╰───────╯
    &kp F1      &kp F2      &kp F_T     &kp F_F     &kp F_A     &kp F6
    &sys_reset  no___       &MF_L       &MF_U       &MF_R       no___
                no___       no___       &MF_D       no___       &kp LS(RA(_Q))
            &bootloader     no___       no___       trs__       no___
                                                                                &kp F7      &MF_1       &MF_2       &MF_3       &kp F11     &kp F12
                                                                                &kp M_AGU   &kp M_GRV   &kp M_CIR   &kp M_TRE   &kp M_TLD   no___
                                                                                no___       no___       no___       no___       no___
                                                                                &kp LSHIFT  trs__       no___       no___       &bt BT_CLR_ALL
, &inc_dec_kp UP DOWN                                                           &inc_dec_kp LEFT RIGHT)

// Pavé numérique, retour à la base du même OS.
LAYER(NUMPAD,
// ┏━━━━━━━━━━━┳━━━━━━━━━━━┳━━━━━━━━━━━┳━━━━━━━━━━━┳━━━━━━━━━━━┳━━━━━━━━━━━┓   ┏━━━━━━━━━━━┳━━━━━━━━━━━┳━━━━━━━━━━━┳━━━━━━━━━━━┳━━━━━━━━━━━┳━━━━━━━━━━━┓
// ┃     ·     ┃     A     ┃     Z     ┃     ↑     ┃     -     ┃     +     ┃   ┃     =     ┃     7     ┃     8     ┃     9     ┃    €/£    ┃     ·     ┃
// ┣━━━━━━━━━━━╋━━━━━━━━━━━╋━━━━━━━━━━━╋━━━━━━━━━━━╋━━━━━━━━━━━╋━━━━━━━━━━━┫   ┣━━━━━━━━━━━╋━━━━━━━━━━━╋━━━━━━━━━━━╋━━━━━━━━━━━╋━━━━━━━━━━━╋━━━━━━━━━━━┫
// ┃     ·     ┃     Y     ┃     ←     ┃     ↓     ┃     →     ┃     *     ┃   ┃     0     ┃     4     ┃     5     ┃     6     ┃     $     ┃     ·     ┃
// ┗━━━━━━━━━━━╋━━━━━━━━━━━╋━━━━━━━━━━━╋━━━━━━━━━━━╋━━━━━━━━━━━╋━━━━━━━━━━━┫   ┣━━━━━━━━━━━╋━━━━━━━━━━━╋━━━━━━━━━━━╋━━━━━━━━━━━╋━━━━━━━━━━━╋━━━━━━━━━━━┛
//             ┃     ∅     ┃     X     ┃     C     ┃     V     ┃     /     ┃   ┃     .     ┃     1     ┃     2     ┃     3     ┃     %     ┃
// ╭───────╮   ┗━━━━━━━━━━━┻━━━━━━━━━━━┻━━━━━━━━━━━┻━━━━━━━━━━━┻━━━━━━━━━━━┛   ┗━━━━━━━━━━━┻━━━━━━━━━━━┻━━━━━━━━━━━┻━━━━━━━━━━━┻━━━━━━━━━━━┛   ╭───────╮
// │  LEFT │ ┏━━━━━━━━━━━┓ ┏━━━━━━━━━━━┳━━━━━━━━━━━┳━━━━━━━━━━━┳━━━━━━━━━━━┓   ┏━━━━━━━━━━━┳━━━━━━━━━━━┳━━━━━━━━━━━┳━━━━━━━━━━━┓ ┏━━━━━━━━━━━┓ │   UP  │
// │ RIGHT │ ┃     ∅     ┃ ┃  COMMAND  ┃     ∅     ┃   BSPACE  ┃    DEL    ┃   ┃   SPACE   ┃    Base   ┃   ENTER   ┃    CTRL   ┃ ┃   Numpad  ┃ │  DOWN │
// ╰───────╯ ┗━━━━━━━━━━━┛ ┗━━━━━━━━━━━┻━━━━━━━━━━━┻━━━━━━━━━━━┻━━━━━━━━━━━┛   ┗━━━━━━━━━━━┻━━━━━━━━━━━┻━━━━━━━━━━━┻━━━━━━━━━━━┛ ┗━━━━━━━━━━━┛ ╰───────╯
    trs__       &kp _A      &kp _Z      &kp UP      &kp M_MINS  &kp M_PLUS
    trs__       &kp _Y      &kp LEFT    &kp DOWN    &kp RIGHT   &astr
                no___       &kp _X      &kp _C      &kp _V      &divi
            no___           &kp M_CMD   no___       &kp BSPC    &kp DEL
                                                                                &kp M_EQAL  &n_7        &n_8        &n_9        &m_eu_li    trs__
                                                                                &n_0        &n_4        &n_5        &n_6        &kp M_DOLR  trs__
                                                                                &kp _DOT    &n_1        &n_2        &n_3        &perc
                                                                                &kp SPACE   &to BASE    &kp ENTER   &kp M_CTL   &numpad
, &inc_dec_kp LEFT RIGHT                                                        &inc_dec_kp UP DOWN)

#ifdef HOST_NEXT_LOCAL
#undef HOST_NEXT
#undef HOST_NEXT_LOCAL
#endif
